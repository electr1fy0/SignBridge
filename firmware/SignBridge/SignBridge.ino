/*
 * SignBridge: flex + MPU6500 recognition, LCD replies, optional haptics,
 * and a self-contained Wi-Fi website. Target: classic ESP32 Dev Module.
 * Install only "esp32 by Espressif Systems" (Arduino core 3.x).
 *
 * Flex T/I/M/R/P: 33/35/36/34/32. MOVE MIDDLE FROM GPIO25 TO GPIO36.
 * MPU SDA/SCL: 21/22. LCD SDA/SCL: 18/19. Motor DRIVER control: 26.
 * Join Wi-Fi SignBridge, password signbridge, open http://192.168.4.1.
 * Keep hand flat, straight and still during startup calibration.
 * No gesture training: 4 hand shapes (fist, point, pinky, index+pinky) and
 * 4 motions (wave, flip, nod, shake) are fixed rules. The chosen environment
 * (everyday, hospital, market, restaurant, classroom) sets each gesture's phrase.
 * Serial 115200: p readings, d motion details, c calibrate, s status,
 * e1..e5 environment, q cancel, ? help (then Enter).
 * Phrase table below is generated from signbridge/public/js/gestures.js.
 *
 * Website below is generated by: node scripts/embed-web.mjs
 * This ONE .ino is all you need to compile and flash; no filesystem upload.
 */
#include <Arduino.h>
#include <Wire.h>
#include <WiFi.h>
#include <Preferences.h>
#include <esp_http_server.h>
#include <cJSON.h>
#include <math.h>
#include <atomic>

#if !CONFIG_IDF_TARGET_ESP32
#error This pin map targets the classic ESP32. Select ESP32 Dev Module.
#endif
#if !CONFIG_HTTPD_WS_SUPPORT
#error The ESP32 Arduino core must include HTTP server WebSocket support.
#endif

// Optional existing network. The glove's own access point stays available.
const char* WIFI_SSID = "";
const char* WIFI_PASSWORD = "";
const char* AP_SSID = "SignBridge";
const char* AP_PASSWORD = "signbridge";

// BEGIN GENERATED WEB
const char WEB_PAGE[] PROGMEM = R"SBWEB(<!doctype html>
<html lang="en">
<head>
  <meta charset="utf-8">
  <meta name="viewport" content="width=device-width,initial-scale=1">
  <meta name="theme-color" content="#f5f5f7" media="(prefers-color-scheme: light)">
  <meta name="theme-color" content="#000000" media="(prefers-color-scheme: dark)">
  <title>SignBridge</title>
  <style>:root {
  color-scheme: light dark;
  --bg: #f5f5f7; --card: #fff; --fill: #e8e8ed; --fill-2: #f2f2f5;
  --text: #1d1d1f; --secondary: #6e6e73; --separator: rgba(0,0,0,.08);
  --accent: #0071e3; --accent-hover: #0077ed; --accent-tint: rgba(0,113,227,.1);
  --red: #e30000; --green: #1f9e47; --hand: #d2d2d7; --palm: #e3e3e8;
  --shadow: 0 1px 2px rgba(0,0,0,.04), 0 6px 24px rgba(0,0,0,.05);
  --radius: 20px;
  font-family: -apple-system, BlinkMacSystemFont, "SF Pro Text", "Segoe UI", Roboto, "Helvetica Neue", Arial, sans-serif;
  font-size: 17px; line-height: 1.47; letter-spacing: -.01em;
  color: var(--text); background: var(--bg);
  -webkit-font-smoothing: antialiased;
}
@media (prefers-color-scheme: dark) {
  :root {
    --bg: #000; --card: #1c1c1e; --fill: #2c2c2e; --fill-2: #232325;
    --text: #f5f5f7; --secondary: #98989d; --separator: rgba(255,255,255,.1);
    --accent: #2997ff; --accent-hover: #47a6ff; --accent-tint: rgba(41,151,255,.16);
    --red: #ff453a; --green: #32d74b; --hand: #48484a; --palm: #3a3a3c;
    --shadow: none;
  }
}
* { box-sizing: border-box; }
body { margin: 0; background: var(--bg); }
h1, h2, h3, p { margin: 0; }
button, input, textarea, select { font: inherit; letter-spacing: inherit; color: inherit; }
a { color: var(--accent); text-decoration: none; }
a:hover { text-decoration: underline; }
[hidden] { display: none !important; }
:focus-visible { outline: 3px solid var(--accent); outline-offset: 2px; border-radius: 8px; }
.visually-hidden { position: absolute; width: 1px; height: 1px; overflow: hidden; clip: rect(0 0 0 0); white-space: nowrap; }
.secondary { color: var(--secondary); }
.small { font-size: 14px; }
.mono { font-family: ui-monospace, "SF Mono", Menlo, Consolas, monospace; white-space: pre-line; font-variant-numeric: tabular-nums; margin-top: 10px; }

/* Buttons */
button { min-height: 36px; padding: 7px 16px; border: 0; border-radius: 999px; background: var(--fill); cursor: pointer; transition: background .15s, transform .1s, opacity .15s; }
button:hover:enabled { background: var(--fill-2); filter: brightness(.97); }
button:active:enabled { transform: scale(.97); }
button:disabled { opacity: .4; cursor: default; }
.primary { background: var(--accent); color: #fff; font-weight: 500; padding: 8px 22px; }
.primary:hover:enabled { background: var(--accent-hover); filter: none; }
.link { background: none; color: var(--accent); padding: 4px 6px; min-height: 0; font-size: 15px; }
.link:hover:enabled { background: none; text-decoration: underline; filter: none; }
.pill { min-height: 30px; padding: 4px 14px; font-size: 14px; font-weight: 500; }
.pill[aria-pressed="true"] { background: var(--accent-tint); color: var(--accent); }

/* Top bar */
.topbar { position: sticky; top: 0; z-index: 5; display: flex; align-items: center; justify-content: space-between; gap: 16px; padding: 12px max(24px, calc((100vw - 1180px) / 2)); background: color-mix(in srgb, var(--bg) 78%, transparent); backdrop-filter: saturate(180%) blur(20px); -webkit-backdrop-filter: saturate(180%) blur(20px); border-bottom: 1px solid var(--separator); }
.brand { font-size: 21px; font-weight: 600; letter-spacing: -.02em; color: var(--text); }
.brand:hover { text-decoration: none; }
.connection { display: flex; align-items: center; gap: 6px; font-size: 14px; }
.status { display: inline-flex; align-items: center; gap: 7px; color: var(--secondary); }
.status::before { content: ""; width: 8px; height: 8px; border-radius: 50%; background: var(--secondary); }
.status[data-online="true"]::before { background: var(--green); box-shadow: 0 0 0 3px color-mix(in srgb, var(--green) 22%, transparent); }
.status[data-online="false"]::before { background: var(--red); }

main { max-width: 1180px; margin: 0 auto; padding: 24px 24px 40px; }
.banner { padding: 12px 16px; margin-bottom: 18px; border-radius: 14px; background: var(--accent-tint); font-size: 15px; }

/* Environment segmented control */
.env-bar { display: flex; justify-content: center; margin: 4px 0 24px; }
.segmented { display: inline-flex; gap: 2px; padding: 3px; border-radius: 12px; background: var(--fill); max-width: 100%; overflow-x: auto; scrollbar-width: none; }
.segmented::-webkit-scrollbar { display: none; }
.segmented button { min-height: 34px; padding: 6px 18px; border-radius: 9px; background: transparent; font-size: 15px; font-weight: 500; white-space: nowrap; color: var(--text); }
.segmented button:hover { filter: none; background: color-mix(in srgb, var(--card) 50%, transparent); }
.segmented button[aria-checked="true"] { background: var(--card); box-shadow: 0 1px 3px rgba(0,0,0,.12), 0 1px 1px rgba(0,0,0,.04); }

/* Cards and layout */
.layout { display: grid; grid-template-columns: minmax(0, 1.55fr) minmax(300px, 1fr); grid-template-areas: "hero hand" "reply conversation"; gap: 20px; }
.card { background: var(--card); border-radius: var(--radius); box-shadow: var(--shadow); padding: 24px; }
.hero { grid-area: hero; min-height: 340px; display: flex; flex-direction: column; justify-content: space-between; }
.hand-card { grid-area: hand; }
.reply { grid-area: reply; }
.conversation { grid-area: conversation; }
.card-head { display: flex; align-items: center; justify-content: space-between; gap: 12px; }
.eyebrow { font-size: 13px; font-weight: 600; letter-spacing: .02em; text-transform: uppercase; color: var(--secondary); }
.phrase { font-size: clamp(36px, 5.6vw, 64px); font-weight: 600; letter-spacing: -.035em; line-height: 1.06; margin: 32px 0; max-width: 16ch; overflow-wrap: anywhere; }
.phrase[data-urgent="true"] { color: var(--red); }
.hero-foot { display: flex; justify-content: space-between; align-items: center; gap: 12px; font-size: 15px; }
.tag { font-size: 13px; font-weight: 600; padding: 4px 11px; border-radius: 999px; background: var(--fill); color: var(--secondary); }
.tag[data-shape="true"] { background: var(--accent-tint); color: var(--accent); }

/* Live hand */
.hand { display: block; width: 100%; max-width: 210px; height: auto; margin: 12px auto 4px; }
.hand .palm { fill: var(--palm); }
.hand .finger { fill: var(--hand); transform-box: fill-box; transform-origin: 50% 100%; transition: transform .25s cubic-bezier(.3,.7,.4,1), fill .2s; }
.hand .finger[data-bent="true"] { fill: var(--accent); }
.chips { list-style: none; display: flex; justify-content: center; flex-wrap: wrap; gap: 6px; padding: 0; margin: 8px 0 18px; }
.chips li { font-size: 12px; font-weight: 500; padding: 3px 10px; border-radius: 999px; background: var(--fill); color: var(--secondary); transition: background .2s, color .2s; }
.chips li[data-bent="true"] { background: var(--accent); color: #fff; }
.meter { border-top: 1px solid var(--separator); padding-top: 14px; }
.meter-head { display: flex; justify-content: space-between; font-size: 14px; margin-bottom: 8px; }
.value { font-variant-numeric: tabular-nums; font-weight: 500; }
.track { position: relative; height: 8px; border-radius: 999px; background: var(--fill); overflow: hidden; }
.fill { height: 100%; width: 0; border-radius: inherit; background: var(--accent); transition: width .3s ease-out; }
.fill[data-moving="true"] { background: #ff9f0a; }
.mark { position: absolute; top: 0; bottom: 0; width: 2px; background: var(--card); }
#motion-summary { margin-top: 10px; }

.hand-foot { display: flex; justify-content: space-between; align-items: center; gap: 10px; margin-top: 14px; padding-top: 12px; border-top: 1px solid var(--separator); }

/* Reply */
.chips-row { display: flex; flex-wrap: wrap; gap: 8px; margin: 14px 0 16px; }
.chips-row button { font-size: 15px; background: var(--accent-tint); color: var(--accent); }
.chips-row button:hover:enabled { filter: brightness(.95); }
.composer { border-radius: 14px; background: var(--fill-2); padding: 4px 4px 10px 4px; }
textarea { display: block; width: 100%; min-height: 70px; resize: vertical; border: 0; background: transparent; padding: 10px 12px; outline: none; }
.composer:focus-within { box-shadow: 0 0 0 3px var(--accent-tint); }
.composer-foot { display: flex; justify-content: space-between; align-items: center; gap: 12px; padding: 0 6px 0 12px; }
.feedback { min-height: 1.4em; margin-top: 10px; color: var(--secondary); }
.feedback[data-error="true"] { color: var(--red); }
.disclosure { margin-top: 8px; border-top: 1px solid var(--separator); }
summary { cursor: pointer; list-style: none; padding: 14px 0 6px; font-weight: 500; color: var(--accent); font-size: 15px; }
summary::-webkit-details-marker { display: none; }
.phrase-filters { display: grid; grid-template-columns: 1fr 1fr; gap: 12px; margin-top: 8px; }
input[type="search"], select { display: block; width: 100%; margin-top: 4px; padding: 8px 12px; border: 0; border-radius: 10px; background: var(--fill-2); color: var(--text); font-size: 15px; }

/* Conversation */
.history { list-style: none; margin: 12px 0 0; padding: 0; max-height: 460px; overflow: auto; }
.history li { padding: 12px 0; border-bottom: 1px solid var(--separator); }
.history li:last-child { border-bottom: 0; }
.history .who { font-size: 12px; font-weight: 600; color: var(--secondary); text-transform: uppercase; letter-spacing: .03em; }
.history .message { font-size: 17px; margin: 2px 0; }
.history .delivery { font-size: 13px; color: var(--secondary); }
.history li[data-type="reply"] .message { color: var(--accent); }
#history-empty { margin-top: 14px; }

/* Gesture guide */
.guide { margin-top: 48px; }
.section-title { font-size: clamp(26px, 3.4vw, 34px); font-weight: 600; letter-spacing: -.025em; margin-bottom: 6px; }
.section-title span { color: var(--accent); }
.gesture-grid { list-style: none; padding: 0; margin: 20px 0 0; display: grid; grid-template-columns: repeat(auto-fill, minmax(240px, 1fr)); gap: 14px; }
.gesture-grid li { background: var(--card); border-radius: 16px; box-shadow: var(--shadow); padding: 16px 18px; display: flex; flex-direction: column; gap: 4px; transition: transform .25s, box-shadow .25s; }
.gesture-grid li[data-active="true"] { transform: translateY(-2px); box-shadow: 0 0 0 2px var(--accent), var(--shadow); }
.gesture-grid .name { font-size: 13px; font-weight: 600; color: var(--secondary); display: flex; justify-content: space-between; }
.gesture-grid .name::after { content: "Shape"; font-weight: 500; }
.gesture-grid li[data-kind="motion"] .name::after { content: "Motion"; }
.gesture-grid .meaning { font-size: 19px; font-weight: 600; letter-spacing: -.02em; }
.gesture-grid small { font-size: 13px; color: var(--secondary); }

/* Device tools */
.tools { margin-top: 40px; padding: 4px 24px; }
.tools > summary { color: var(--text); font-size: 17px; font-weight: 600; padding: 16px 0; display: flex; align-items: baseline; gap: 12px; flex-wrap: wrap; }
.tools[open] { padding-bottom: 24px; }
.notice { padding: 12px 14px; border-radius: 12px; background: var(--fill-2); }
.tools-actions { display: flex; flex-wrap: wrap; gap: 8px; margin: 14px 0 10px; }
.tools-actions button { font-size: 15px; }
.table-scroll { overflow-x: auto; margin: 18px 0 6px; }
.sensors { border-collapse: collapse; width: 100%; max-width: 680px; font-size: 14px; font-variant-numeric: tabular-nums; }
.sensors caption { text-align: left; font-weight: 600; margin-bottom: 6px; }
.sensors caption span { margin-left: 10px; color: var(--accent); font-family: ui-monospace, "SF Mono", Menlo, Consolas, monospace; }
/* Bend triggers: a range input layered over the live bend bar */
.bend-panel { margin-top: 22px; padding-top: 18px; border-top: 1px solid var(--separator); }
.bend-panel h3 { font-size: 17px; font-weight: 600; margin-bottom: 4px; }
.bend-rows { list-style: none; padding: 0; margin: 14px 0 4px; max-width: 680px; }
.bend-rows li { display: grid; grid-template-columns: 64px minmax(0, 1fr) 92px; align-items: center; gap: 14px; padding: 6px 0; font-size: 15px; }
.bend-track { position: relative; height: 30px; }
.bend-track::before, .bend-live { content: ""; position: absolute; left: 0; top: 11px; height: 8px; border-radius: 999px; }
.bend-track::before { right: 0; background: var(--fill); }
.bend-live { width: 0; background: var(--hand); transition: width .3s ease-out, background .2s; }
.bend-live[data-bent="true"] { background: var(--accent); }
.bend-track input { position: absolute; inset: 0; width: 100%; margin: 0; background: transparent; -webkit-appearance: none; appearance: none; cursor: pointer; }
.bend-track input::-webkit-slider-runnable-track { background: transparent; height: 30px; }
.bend-track input::-moz-range-track { background: transparent; }
.bend-track input::-webkit-slider-thumb { -webkit-appearance: none; width: 6px; height: 26px; margin-top: 2px; border-radius: 3px; background: var(--text); box-shadow: 0 0 0 2px var(--card); }
.bend-track input::-moz-range-thumb { width: 6px; height: 26px; border: 0; border-radius: 3px; background: var(--text); box-shadow: 0 0 0 2px var(--card); }
.bend-value { font-variant-numeric: tabular-nums; font-size: 13px; color: var(--secondary); text-align: right; }
.bend-value strong { color: var(--text); font-weight: 600; }
th, td { text-align: left; padding: 8px 14px 8px 0; border-bottom: 1px solid var(--separator); }
th { color: var(--secondary); font-weight: 500; }
.settings { margin-top: 22px; padding-top: 18px; border-top: 1px solid var(--separator); }
.settings h3 { font-size: 17px; font-weight: 600; }
.settings label { display: flex; align-items: flex-start; gap: 10px; margin: 12px 0; font-size: 15px; }
.settings input { margin-top: 4px; width: 17px; height: 17px; accent-color: var(--accent); }
.settings button { margin-top: 12px; }

footer { max-width: 1180px; margin: 0 auto; padding: 0 24px 32px; }

@media (max-width: 820px) {
  .layout { grid-template-columns: 1fr; grid-template-areas: "hero" "hand" "reply" "conversation"; gap: 14px; }
  .env-bar { justify-content: flex-start; margin-bottom: 16px; }
  .topbar { padding: 10px 16px; }
  main { padding: 16px 16px 32px; }
  .card { padding: 20px; }
  .hero { min-height: 240px; }
  .phrase { margin: 22px 0; }
  .phrase-filters { grid-template-columns: 1fr; }
  .bend-rows li { grid-template-columns: 52px minmax(0, 1fr) 76px; gap: 10px; }
  .tools { padding: 4px 20px; }
  footer { padding: 0 16px 24px; }
}
@media (prefers-reduced-motion: reduce) { * { transition: none !important; } }
</style>
</head>
<body>
  <header class="topbar">
    <a class="brand" href="/" aria-label="SignBridge home">SignBridge</a>
    <div class="connection"><span id="connection" class="status" role="status">Connecting…</span><button id="reconnect" class="link" type="button">Reconnect</button></div>
  </header>
  <main>
    <p id="connection-help" class="banner" hidden>Join the glove’s Wi-Fi, then open <a href="http://192.168.4.1">192.168.4.1</a>. Keep this page open while communicating.</p>

    <nav class="env-bar" aria-label="Environment">
      <div id="environments" class="segmented" role="radiogroup" aria-label="Environment"></div>
    </nav>

    <div class="layout">
      <section class="card hero" aria-labelledby="translation-heading">
        <div class="card-head"><h1 id="translation-heading" class="eyebrow">From the glove</h1><button id="sound" class="pill" type="button" aria-pressed="false">Enable voice</button></div>
        <p id="translation" class="phrase" role="status" aria-live="polite">Ready when you are.</p>
        <div class="hero-foot"><span id="sign-detail" class="secondary">Make a gesture to begin.</span><button id="replay" class="link" type="button" disabled>Speak again</button></div>
      </section>

      <section class="card hand-card" aria-labelledby="hand-heading">
        <div class="card-head"><h2 id="hand-heading" class="eyebrow">Live hand</h2><span id="hand-shape" class="tag">Waiting</span></div>
        <svg id="hand" class="hand" viewBox="0 0 200 236" role="img" aria-label="Finger bend from the flex sensors">
          <rect class="finger" data-finger="1" x="50" y="46" width="22" height="92" rx="11"/>
          <rect class="finger" data-finger="2" x="77" y="36" width="22" height="102" rx="11"/>
          <rect class="finger" data-finger="3" x="104" y="44" width="22" height="94" rx="11"/>
          <rect class="finger" data-finger="4" x="130" y="62" width="20" height="76" rx="10"/>
          <g transform="rotate(-40 62 186)"><rect class="finger" data-finger="0" x="51" y="126" width="22" height="74" rx="11"/></g>
          <rect class="palm" x="46" y="108" width="108" height="112" rx="36"/>
        </svg>
        <ul id="finger-chips" class="chips" aria-label="Bent fingers"></ul>
        <div class="meter" aria-label="Hand movement">
          <div class="meter-head"><span class="secondary">Movement</span><span id="speed" class="value">—</span></div>
          <div class="track"><div id="speed-fill" class="fill"></div><span class="mark" style="left:11.7%" title="Still"></span><span class="mark" style="left:30%" title="Motion starts"></span></div>
          <p id="motion-summary" class="secondary small">Shake, flip, wave or nod with an open hand.</p>
        </div>
        <div class="hand-foot"><span class="secondary small">Calibrate with a flat, still hand after putting the glove on.</span><button id="recalibrate" class="link" type="button" disabled>Recalibrate</button></div>
      </section>

      <section class="card reply" aria-labelledby="reply-heading">
        <h2 id="reply-heading" class="eyebrow">Reply to the glove</h2>
        <div id="quick-replies" class="chips-row" aria-label="Suggested replies"></div>
        <form id="reply-form" class="composer">
          <label for="reply-text" class="visually-hidden">Your message</label>
          <textarea id="reply-text" rows="2" maxlength="160" placeholder="Type a reply for the glove’s screen" required></textarea>
          <div class="composer-foot"><span id="lcd-preview" class="secondary small">Up to two lines on the glove’s display.</span><button id="send" class="primary" type="submit" disabled>Send</button></div>
        </form>
        <p id="feedback" class="feedback small" role="status" aria-live="polite"></p>
        <details class="disclosure"><summary>Phrase library</summary><div class="phrase-filters"><label class="small secondary">Situation<select id="scenario"><option value="everyday">Everyday</option></select></label><label class="small secondary">Search<input id="phrase-search" type="search" placeholder="Search phrases"></label></div><div id="phrase-list" class="chips-row"></div></details>
      </section>

      <section class="card conversation" aria-labelledby="conversation-heading">
        <div class="card-head"><h2 id="conversation-heading" class="eyebrow">Conversation</h2><button id="clear" class="link" type="button">Clear</button></div>
        <p id="history-empty" class="secondary small">Gestures and replies appear here.</p>
        <ol id="history" class="history" aria-live="polite" aria-relevant="additions"></ol>
      </section>
    </div>

    <section class="guide" aria-labelledby="guide-heading">
      <h2 id="guide-heading" class="section-title">Gestures in <span id="guide-env">Everyday</span></h2>
      <p class="secondary">Same eight gestures, different meaning in every place. Hold a shape for half a second. Start motions from a still, open hand.</p>
      <ol id="gesture-guide" class="gesture-grid"></ol>
    </section>

    <details id="device-tools" class="card tools">
      <summary><span>Device tools</span> <span id="sensor-summary" class="secondary small">Waiting for glove</span></summary>
      <p id="device-notice" class="notice small" role="status">Calibration instructions appear here.</p>
      <div class="tools-actions"><button id="calibrate" type="button" disabled>Calibrate hand</button><button id="cancel" type="button" disabled>Cancel</button><button id="live" type="button" aria-pressed="true" disabled>Serial values: on</button><button id="debug" type="button" aria-pressed="false" disabled>Serial motion details: off</button></div>
      <p class="secondary small">Calibration runs at startup and records the straight-hand flex readings and the still gyro. Re-run it whenever the glove is put on again: straighten your fingers and hold your hand flat and still. Serial output is 115200 baud.</p>
      <section class="bend-panel" aria-labelledby="bend-heading">
        <h3 id="bend-heading">Bend triggers</h3>
        <p class="secondary small">The bar is each finger’s live change from calibration; drag the handle to where it should count as bent. Lower triggers more easily. A finger reads straight again below two thirds of its trigger.</p>
        <ul id="bend-rows" class="bend-rows"></ul>
        <div class="tools-actions"><button id="save-bend" class="primary" type="button" disabled>Save triggers</button><button id="reset-bend" type="button" disabled>Reset to defaults</button></div>
      </section>
      <div class="table-scroll"><table class="sensors"><caption>Flex sensors <span id="pattern">—</span></caption><thead><tr><th scope="col">Finger</th><th scope="col">GPIO</th><th scope="col">Raw</th><th scope="col">Baseline</th><th scope="col">Change</th></tr></thead><tbody id="sensor-rows"></tbody></table></div>
      <p id="imu-values" class="mono small">Accelerometer and gyroscope unavailable.</p>
      <p id="motion-values" class="mono small">No motion analysed yet.</p>
      <form id="settings" class="settings"><h3>Connected hardware</h3><label><input id="use-flex" type="checkbox" checked> Use flex sensors for hand shapes</label><label><input id="use-motor" type="checkbox"> Vibration motor driver connected to GPIO26</label><p class="secondary small">Middle flex input is GPIO36. GPIO25 cannot be used for flex readings with Wi-Fi enabled.</p><button id="save-settings" type="submit" disabled>Save hardware settings</button></form>
    </details>
  </main>
  <footer class="secondary small">Recognition runs on the glove. Voice plays on this device.</footer>
  <script type="module">
// Gesture catalogue and per-environment meanings. Pure data shared by the
// website, the tests and the firmware table generated by scripts/embed-web.mjs.
// Key order is the firmware's gesture index order: hand shapes first, then motions.

const GESTURES = {
  FIST: { name: 'Fist', kind: 'shape', how: 'Close all fingers into a fist and hold still' },
  POINT: { name: 'Point', kind: 'shape', how: 'Index finger up, other fingers closed' },
  PINKY: { name: 'Pinky up', kind: 'shape', how: 'Pinky up, other fingers closed' },
  ROCK: { name: 'Index + pinky', kind: 'shape', how: 'Index and pinky up, middle and ring closed (thumb either way)' },
  WAVE: { name: 'Wave', kind: 'motion', how: 'Open hand, wave side to side two or three times at a relaxed pace' },
  FLIP: { name: 'Flip', kind: 'motion', how: 'Open hand palm down, turn it palm up in one go and hold it there' },
  NOD: { name: 'Nod', kind: 'motion', how: 'Open hand, flick the wrist down and straight back up once, then hold still' },
  SHAKE: { name: 'Shake', kind: 'motion', how: 'Shake quickly, like shaking water off, for about a second (any hand shape)', urgent: true },
};

// Replies may be plain strings or {text, lcd:[line1, line2]} when the auto LCD wrap would be ugly.
// Phrases may also carry lcd:[line1, line2]; otherwise the firmware table uses formatLcd().
const ENVIRONMENTS = [
  {
    id: 'everyday',
    name: 'Everyday',
    phrases: {
      FIST: { text: 'Yes.', replies: ['Okay, got it.', 'Great!', 'Are you sure?'] },
      POINT: { text: 'I have a question.', replies: ['Go ahead.', 'Sure, ask me.', 'Please write it down.'] },
      PINKY: { text: 'Where is the washroom?', replies: ["It's straight ahead.", "I'll show you.", 'On the left.'] },
      ROCK: { text: 'I love it!', replies: ["I'm glad!", 'That makes me happy.'] },
      WAVE: { text: 'Hello!', replies: ['Hello!', 'How are you?', 'Nice to meet you!'] },
      FLIP: { text: 'Thank you.', replies: ["You're welcome!", 'Happy to help.', 'Anytime!'] },
      NOD: { text: 'Please repeat that.', replies: ["Sure, I'll repeat it.", "I'll write it down."] },
      SHAKE: { text: 'Emergency! Please help me.', replies: ["I'm coming!", 'Calling for help now.', 'Stay calm, help is coming.'] },
    },
  },
  {
    id: 'hospital',
    name: 'Hospital',
    phrases: {
      FIST: { text: 'I am in pain.', replies: ['Where does it hurt?', "I'll call the doctor.", 'Is it urgent?'] },
      POINT: { text: 'It hurts here.', replies: ['Show me where.', "I'll tell the doctor.", 'Since when?'] },
      PINKY: { text: 'I need the washroom.', replies: ["I'll help you there.", 'Can you walk?'] },
      ROCK: { text: 'I feel better now.', replies: ["That's good news!", "I'll tell the doctor.", 'Please keep resting.'] },
      WAVE: { text: 'Nurse, please come.', replies: ["I'm coming.", 'One minute, please.'] },
      FLIP: { text: 'Thank you, doctor.', replies: ["You're welcome.", 'Get well soon!'] },
      NOD: { text: 'I need water.', replies: ["I'll get you some water.", 'Here you go!'] },
      SHAKE: { text: 'Emergency! Call a doctor.', replies: ['Calling the doctor now!', 'Help is coming.', 'Stay calm.'] },
    },
  },
  {
    id: 'market',
    name: 'Market',
    phrases: {
      FIST: { text: "Yes, I'll buy it.", replies: ['Great choice!', 'Cash or UPI?', "I'll pack it."] },
      POINT: { text: 'How much is this?', replies: ['It is 100 rupees.', 'It is 50 rupees.', 'Let me check.'] },
      PINKY: { text: 'Do you have a smaller one?', replies: ['Yes, here it is.', 'Sorry, only this size.'] },
      ROCK: { text: 'Good price, deal!', replies: ['Deal!', 'Thank you!'] },
      WAVE: { text: 'Excuse me!', replies: ['Yes, how can I help?', 'One minute, please.'] },
      FLIP: { text: 'Can I get a discount?', replies: ['Okay, 10 percent off.', 'Sorry, fixed price.'] },
      NOD: { text: 'Can I pay by UPI?', replies: ['Yes, scan this code.', 'Cash only, sorry.'] },
      SHAKE: { text: 'Emergency! Please help me.', replies: ["I'm coming!", 'Calling for help now.', 'Stay calm.'] },
    },
  },
  {
    id: 'restaurant',
    name: 'Restaurant',
    phrases: {
      FIST: { text: 'Yes, please.', replies: ['Coming right up!', 'Sure.'] },
      POINT: { text: 'I want this one.', replies: ['Good choice!', 'Anything else?'] },
      PINKY: { text: 'Where is the washroom?', replies: ["It's at the back.", "I'll show you."] },
      ROCK: { text: 'The food is great!', replies: ['Thank you!', "I'll tell the chef!"] },
      WAVE: { text: 'Waiter, please!', replies: ['Coming!', 'One moment, please.'] },
      FLIP: { text: 'The bill, please.', replies: ["I'll bring the bill.", 'Card or cash?'] },
      NOD: { text: 'Water, please.', replies: ["I'll get you some water.", 'Cold or normal?'] },
      SHAKE: { text: 'Emergency! Please help me.', replies: ["I'm coming!", 'Calling for help now.', 'Stay calm.'] },
    },
  },
  {
    id: 'classroom',
    name: 'Classroom',
    phrases: {
      FIST: { text: "Yes, I'm here.", replies: ['Thank you.', 'Marked present.'] },
      POINT: { text: 'I have a question.', replies: ['Go ahead.', 'Please write it down.'] },
      PINKY: { text: 'May I go to the washroom?', replies: ['Yes, you may go.', 'Please wait a minute.'] },
      ROCK: { text: 'I understand.', replies: ['Great!', "Let's continue."] },
      WAVE: { text: 'Good morning!', replies: ['Good morning!', 'Please sit down.'] },
      FLIP: { text: 'Thank you, teacher.', replies: ["You're welcome!", 'Good work today.'] },
      NOD: { text: 'Please repeat that.', replies: ["Sure, I'll repeat it.", "I'll write it on the board."] },
      SHAKE: { text: 'Emergency! Please help me.', replies: ["I'm coming!", 'Calling for help now.', 'Stay calm.'] },
    },
  },
];

const DEFAULT_REPLIES = ['Yes', 'No', 'Give me a minute', 'Please repeat that.'];

function environment(id) {
  return ENVIRONMENTS.find((env) => env.id === id) ?? ENVIRONMENTS[0];
}

/** "thumbs_up", " Fist " → "FIST". Changes formatting only, never meaning. */
function normalizeGesture(raw) {
  return String(raw).trim().toUpperCase().replace(/[_\s]+/g, ' ');
}

/** @returns {{key:string, gesture:string, text:string, env:string, known:boolean, urgent:boolean, replies:Array}} */
function meaning(rawGesture, envId) {
  const key = normalizeGesture(rawGesture);
  const env = environment(envId);
  const gesture = GESTURES[key];
  const phrase = env.phrases[key];
  if (!gesture || !phrase) return { key, gesture: key, text: key, env: env.name, known: false, urgent: false, replies: DEFAULT_REPLIES };
  return { key, gesture: gesture.name, text: phrase.text, env: env.name, known: true, urgent: Boolean(gesture.urgent), replies: phrase.replies };
}

/** Normalise a reply entry to {text, lcd?}. */
function replyItem(entry) {
  return typeof entry === 'string' ? { text: entry } : entry;
}


// Phrase library for the hearing partner's replies: everyday phrases plus
// scenario lists. Pure data. Glove gestures and their meanings live in gestures.js.

const GENERIC = [
  { text: 'Okay', replies: ['Great!', 'Okay, got it.', 'Anything else?'] },
  { text: 'Hello', replies: ['Hello!', 'How are you?', 'Nice to meet you!', 'What do you need?'] },
  { text: 'Goodbye', replies: ['Goodbye!', 'See you later!', 'Take care!'] },
  { text: 'Thank you', replies: ["You're welcome!", 'Happy to help.', 'Anytime!'] },
  { text: 'Please', replies: ['Of course.', 'What do you need?'] },
  { text: 'Yes', replies: ['Okay, got it.', 'Great!'] },
  { text: 'No', replies: ['Okay, no problem.', 'What would you like instead?'] },
  { text: 'Excuse me', replies: ['Yes?', 'How can I help?'] },
  { text: 'Sorry', replies: ["It's okay.", 'No problem.'] },
  { text: 'Help me', replies: ["I'm coming.", 'What happened?', "I'll call someone."] },
  { text: 'I need water', replies: ["I'll get you some water.", 'Here you go!'] },
  { text: 'I need food', replies: ["I'll get you something.", 'What would you like?'] },
  { text: 'I am tired', replies: ['Do you want to rest?', 'Shall we take a break?'] },
  { text: 'I am in pain', replies: ['Where does it hurt?', "I'll get a doctor.", 'Do you need medicine?'] },
  { text: 'I need assistance', replies: ["I'm coming.", 'What do you need?'] },
  { text: 'Wait', replies: ["Okay, I'll wait.", 'Take your time.'] },
  { text: 'Come here', replies: ['Coming!', 'Give me a minute'] },
  { text: 'Slow down', replies: ["Sorry, I'll slow down.", 'Should I repeat that?'] },
  { text: 'I am finished', replies: ['Great job!', 'Anything else?'] },
  { text: "I don't understand", replies: ['Let me repeat.', "I'll write it down.", 'Let me show you.'] },
];

const SCENARIOS = [
  {
    id: 'cafe',
    name: 'Cafe / Coffee shop',
    phrases: [
      { text: 'I want coffee.', replies: ['What kind of coffee?', 'Hot or iced?', 'Coming right up!'] },
      { text: 'The coffee is cold.', replies: ["I'll heat it for you.", 'Would you like another coffee?', 'Is it too cold to drink?'] },
      { text: 'I need water.', replies: ["I'll get you some water.", 'Here you go!'] },
      { text: 'I want the bill.', replies: ["I'll bring the bill.", 'Card or cash?'] },
      { text: 'No sugar, please.', replies: ['No sugar, got it.', 'Any milk?'] },
      { text: 'Thank you.', replies: ["You're welcome!", 'Enjoy your coffee!'] },
    ],
  },
  {
    id: 'restaurant',
    name: 'Restaurant',
    phrases: [
      { text: 'I want to see the menu.', replies: ["Here's the menu.", 'One moment, please.'] },
      { text: 'I am hungry.', replies: ['What would you like to eat?', "I'll get the menu."] },
      { text: 'I need water.', replies: ["I'll get you some water.", 'Still or sparkling?'] },
      { text: 'This food is too hot.', replies: ['Let it cool a little.', 'Would you like cold water?'] },
      { text: 'I need a spoon.', replies: ["I'll bring a spoon.", 'Here you go!'] },
      { text: 'Please call the waiter.', replies: ["I'll call the waiter.", 'The waiter is coming.'] },
      { text: 'The bill, please.', replies: ["I'll bring the bill.", 'Card or cash?'] },
    ],
  },
  {
    id: 'market',
    name: 'Market / Shop',
    phrases: [
      { text: 'It is 100 rupees.', replies: [] },
      { text: 'Cash or UPI?', replies: [] },
      { text: 'Which size do you want?', replies: [] },
      { text: 'Okay, 10 percent off.', replies: [] },
      { text: 'Sorry, fixed price.', replies: [] },
      { text: "I'll pack it for you.", replies: [] },
    ],
  },
  {
    id: 'classroom',
    name: 'Classroom / College',
    phrases: [
      { text: "I don't understand.", replies: ['Let me explain again.', "I'll write it down.", 'Which part?'] },
      { text: 'Please repeat that.', replies: ["Sure, I'll repeat it.", "I'll write it on the board."] },
      { text: 'I have a question.', replies: ['Go ahead.', 'Please write it down.'] },
      { text: 'Can you help me?', replies: ['Yes, of course.', 'Give me a minute'] },
      { text: 'I need to leave.', replies: ['Okay, you may go.', 'Is everything okay?'] },
      { text: 'Thank you, teacher.', replies: ["You're welcome!", 'Good work today.'] },
    ],
  },
  {
    id: 'travel',
    name: 'Train station / Airport',
    phrases: [
      { text: 'Where is the platform?', replies: ['Platform 2, on the left.', "I'll show you.", 'Which train?'] },
      { text: 'Where is the gate?', replies: ["I'll show you.", 'Can I see your ticket?'] },
      { text: 'I need help.', replies: ['How can I help?', "I'll find staff."] },
      { text: 'Where is the restroom?', replies: ["It's straight ahead.", "I'll show you."] },
      { text: 'I need a ticket.', replies: ['The ticket counter is there.', 'Where are you going?'] },
      { text: 'I am lost.', replies: ["Don't worry, I'll help.", 'Where are you going?'] },
      { text: 'Please help me find my train.', replies: ['Which train?', 'Can I see your ticket?', "I'll show you."] },
    ],
  },
  {
    id: 'hospital',
    name: 'Hospital / Emergency',
    phrases: [
      { text: 'I need a doctor.', replies: ["I'll call a doctor.", 'The doctor is coming.', 'Is it urgent?'] },
      { text: 'I am in pain.', replies: ['Where does it hurt?', "I'll call the doctor now.", 'Is it urgent?'] },
      { text: 'I need water.', replies: ["I'll get you some water.", 'Here you go!'] },
      { text: 'Please call for help.', replies: ['Calling for help now.', 'Help is coming.'] },
      { text: 'I need assistance.', replies: ["I'm coming.", 'What do you need?'] },
    ],
  },
];

/** Flat list for search: [{text, replies, scenario}] */
function allPhrases() {
  return [
    ...GENERIC.map((p) => ({ ...p, scenario: 'Everyday' })),
    ...SCENARIOS.flatMap((s) => s.phrases.map((p) => ({ ...p, scenario: s.name }))),
  ];
}

function findPhrase(text) {
  const t = String(text).trim().toLowerCase();
  return allPhrases().find((p) => p.text.toLowerCase() === t) ?? null;
}


// LCD formatting and haptic codes shared with the unified firmware.
const LCD_COLS = 16;
const LCD_ROWS = 2;

/** Upper-case and strip characters a HD44780 / PCF8574 LCD can't show reliably. */
function lcdSanitize(text) {
  return String(text)
    .replace(/[\u2018\u2019]/g, "'")
    .toUpperCase()
    .replace(/[^A-Z0-9 .,!?'-]/g, ' ')
    .replace(/\s+/g, ' ')
    .trim();
}

/**
 * Word-wrap to 2 x 16. Longer text is truncated with ".." on line 2;
 * the website always keeps the full message.
 * @param {string} text
 * @param {string[]} [override] hand-written [line1, line2] for known replies
 * @returns {{lines:[string,string], truncated:boolean}}
 */
function formatLcd(text, override) {
  if (override) {
    const [a = '', b = ''] = override.map((l) => lcdSanitize(l).slice(0, LCD_COLS));
    return { lines: [a, b], truncated: false };
  }
  const lines = [];
  let cur = '';
  for (let word of lcdSanitize(text).split(' ').filter(Boolean)) {
    while (word.length > LCD_COLS) {
      if (cur) { lines.push(cur); cur = ''; }
      lines.push(word.slice(0, LCD_COLS));
      word = word.slice(LCD_COLS);
    }
    if (!word) continue;
    if (!cur) cur = word;
    else if (cur.length + 1 + word.length <= LCD_COLS) cur += ' ' + word;
    else { lines.push(cur); cur = word; }
  }
  if (cur) lines.push(cur);

  if (lines.length <= LCD_ROWS) return { lines: [lines[0] ?? '', lines[1] ?? ''], truncated: false };
  const rest = lines.slice(1).join(' ');
  return { lines: [lines[0], rest.slice(0, LCD_COLS - 2).trimEnd() + '..'], truncated: true };
}

/** Suggested motor patterns, in ms: [on, off, on, …]. Implemented by the unified firmware. */
const VIBES = {
  ACK: { label: 'Short pulse', meaning: 'Acknowledgment / simple confirmation', pattern: [150] },
  YES: { label: 'Two short pulses', meaning: 'Yes', pattern: [150, 150, 150] },
  NO: { label: 'One long pulse', meaning: 'No', pattern: [800] },
  MSG: { label: 'Three short pulses', meaning: 'Incoming message / attention', pattern: [150, 150, 150, 150, 150] },
  URGENT: { label: 'Long-short repeated ×3', meaning: 'Urgent assistance', pattern: [500, 120, 150, 120, 500, 120, 150, 120, 500, 120, 150] },
};

function vibFor(text) {
  const t = String(text).trim().toLowerCase();
  if (/\b(help|doctor|emergency|urgent|ambulance)\b/.test(t)) return 'URGENT';
  if (/^(yes|yeah|yep)\b/.test(t)) return 'YES';
  if (/^(no|nope)\b(?!\s+problem)/.test(t)) return 'NO';
  if (/^(okay|ok|got it|sure|done)\b/.test(t)) return 'ACK';
  return 'MSG';
}

/** Unique-enough id that also works outside secure contexts (crypto.randomUUID doesn't on LAN http). */
function makeUid() {
  return Date.now().toString(36) + Math.random().toString(36).slice(2, 8);
}


// Web Speech API (Text-to-Speech) manager.
// Handles English voice selection, queue management, mute/unmute, replay, and user-activation unlocks.

class TextToSpeechManager {
  #synth = null;
  #voice = null;
  #muted = false;
  #lastSpokenText = '';
  #onStateChange = null;
  #onError = null;
  #unlocked = false;

  constructor({ onStateChange, onError } = {}) {
    this.#onStateChange = onStateChange || (() => {});
    this.#onError = onError || (() => {});
    if (typeof window !== 'undefined' && 'speechSynthesis' in window) {
      this.#synth = window.speechSynthesis;
      this.#muted = localStorage.getItem('signbridge_muted') === 'true';
      this.#loadVoices();
      if (this.#synth.onvoiceschanged !== undefined) {
        this.#synth.onvoiceschanged = () => this.#loadVoices();
      }
    }
  }

  isSupported() {
    return Boolean(this.#synth);
  }

  isMuted() {
    return this.#muted;
  }

  isUnlocked() {
    return this.#unlocked;
  }

  getLastSpokenText() {
    return this.#lastSpokenText;
  }

  #loadVoices() {
    if (!this.#synth) return;
    const voices = this.#synth.getVoices();
    if (!voices || voices.length === 0) return;

    // Preference: English natural voices, en-US / en-GB
    const englishVoices = voices.filter((v) => v.lang.startsWith('en'));
    // The glove's access point has no internet. Prefer installed voices over
    // network voices even when a remote voice sounds more natural.
    const localVoices = englishVoices.filter((v) => v.localService);
    const candidates = localVoices.length ? localVoices : englishVoices;
    const preferred = candidates.find((v) =>
      /natural|google|samantha|karen|daniel|moira/i.test(v.name)
    ) || candidates[0] || voices[0];

    this.#voice = preferred;
    this.#notifyState();
  }

  #notifyState() {
    this.#onStateChange({
      supported: this.isSupported(),
      muted: this.#muted,
      voiceName: this.#voice ? this.#voice.name : 'Default',
      lastText: this.#lastSpokenText,
      unlocked: this.#unlocked,
    });
  }

  toggleMute() {
    this.#muted = !this.#muted;
    localStorage.setItem('signbridge_muted', String(this.#muted));
    if (this.#muted && this.#synth) {
      this.#synth.cancel();
    }
    this.#notifyState();
    return this.#muted;
  }

  /**
   * Unlock speech synthesis on browsers that require user gesture activation.
   * Plays a silent utterance or brief confirmation.
   */
  unlock() {
    if (!this.#synth) return;
    this.#unlocked = true;
    try {
      const u = new SpeechSynthesisUtterance(' ');
      u.volume = 0.01;
      this.#synth.speak(u);
    } catch (e) {
      console.warn('[TTS] Unlock attempt:', e);
    }
    this.#notifyState();
  }

  /**
   * Speak a phrase aloud immediately. Cancels any stale pending speech to prevent backlog.
   * If speech fails or is muted, returns false without throwing so UI translation is never delayed.
   */
  speak(text) {
    if (!text || typeof text !== 'string') return false;
    this.#lastSpokenText = text;
    this.#notifyState();

    if (!this.#synth || this.#muted) return false;

    try {
      // Clear backlog so new signs are heard without stale delay
      this.#synth.cancel();

      const utterance = new SpeechSynthesisUtterance(text);
      if (this.#voice) {
        utterance.voice = this.#voice;
      }
      utterance.lang = 'en-US';
      utterance.rate = 0.95; // Slightly measured rate for clear assistive audio
      utterance.pitch = 1.0;
      utterance.volume = 1.0;

      utterance.onerror = (err) => {
        // SpeechSynthesis interrupted or cancelled is expected when new signs arrive
        if (err.error !== 'interrupted' && err.error !== 'canceled') {
          console.warn('[TTS] Speech error:', err);
          this.#onError('Voice could not play. Check audio or install an offline English voice on this device.');
        }
      };

      this.#synth.speak(utterance);
      this.#unlocked = true;
      this.#notifyState();
      return true;
    } catch (err) {
      console.warn('[TTS] Speak failed:', err);
      return false;
    }
  }

  /** Replay the last spoken text */
  replay() {
    if (this.#lastSpokenText) {
      this.speak(this.#lastSpokenText);
    }
  }
}


// State validation and replay handling shared by the live UI and tests.
function validateState(state) {
  if (!state || state.type !== 'state' || typeof state.boot !== 'string' || !Number.isFinite(state.uptime)) throw new Error('This address is not running SignBridge firmware.');
  for (const [key, length] of [['flex', 5], ['delta', 5], ['baseline', 5], ['acc', 3], ['gyro', 3], ['bendOn', 5]]) {
    if (!Array.isArray(state[key]) || state[key].length !== length) throw new Error(`Incomplete device data: ${key}`);
  }
  if (typeof state.env !== 'string') throw new Error('Incomplete device data: env');
  if (!Array.isArray(state.events)) throw new Error('Missing device event history.');
  return state;
}

function consumeEvents(cursor, state) {
  const changedBoot = cursor.boot !== state.boot;
  const previous = changedBoot ? 0 : cursor.seq;
  const events = state.events.filter((event) => Number.isInteger(event.seq) && event.seq > previous && ['sign', 'reply'].includes(event.type)).sort((a, b) => a.seq - b.seq);
  // Initial history and restart history are shown, but never spoken again.
  const audible = changedBoot ? [] : events.filter((event) => event.type === 'sign');
  return { cursor: { boot: state.boot, seq: Math.max(previous, ...events.map((event) => event.seq)) }, events, audible };
}

function replyDelivery(event) {
  return event.lcd ? `Written to glove LCD${event.haptic ? '; vibration triggered' : ''}` : 'Received by glove; LCD unavailable';
}


const $ = (id) => document.getElementById(id);
const voice = new TextToSpeechManager({ onError: (message) => feedback(message, true) });
let state = null, online = false, cursor = { boot: null, seq: 0 };
let socket = null, retryTimer = null, lastPacket = 0, retryDelay = 800, generation = 0;
let lastTranslation = '', settingsDirty = false, bendDirty = false, displayedNotice = '', shownEnv = null, flashTimer = null, requestedEnv = null;
const pending = new Map();
const rows = new Map();
const fingerNames = ['Thumb', 'Index', 'Middle', 'Ring', 'Pinky'];
const pins = [33, 35, 36, 34, 32];
const BEND_SCALE = 600; // change shown at the right end of each bend bar
const SHAPE_NAMES = { FIST: 'Fist', POINT: 'Point', PINKY: 'Pinky up', ROCK: 'Index + pinky' };

function feedback(text, error = false) {
  $('feedback').textContent = text;
  $('feedback').dataset.error = String(error);
}
function availability() {
  const busy = state?.job !== 0;
  $('send').disabled = !online;
  $('calibrate').disabled = $('recalibrate').disabled = !online || busy;
  $('save-bend').disabled = !online || !bendDirty;
  $('reset-bend').disabled = !online;
  $('cancel').disabled = !online || !busy;
  for (const id of ['live', 'debug']) $(id).disabled = !online;
  $('save-settings').disabled = !online || busy;
  for (const button of $('quick-replies').querySelectorAll('button')) button.disabled = !online;
}
function connection(connected, label) {
  online = connected;
  if ($('connection').textContent !== label) $('connection').textContent = label;
  $('connection').dataset.online = String(connected);
  $('connection-help').hidden = connected;
  availability();
}
async function command(op, fields = {}) {
  if (!online) throw new Error('Glove disconnected. Reconnect before sending.');
  const response = await fetch('/api/command', {
    method: 'POST', headers: { 'Content-Type': 'application/json' },
    body: JSON.stringify({ op, ...fields }), signal: AbortSignal.timeout(5000),
  });
  if (!response.ok) throw new Error((await response.text()).slice(0, 160) || 'Device could not accept the command.');
  return response.json();
}
function run(op, fields) {
  return command(op, fields).catch((error) => feedback(error.message, true));
}
function renderQuickReplies(replies) {
  $('quick-replies').replaceChildren();
  for (const entry of replies) {
    const reply = replyItem(entry);
    const button = document.createElement('button'); button.type = 'button'; button.textContent = reply.text;
    button.disabled = !online; button.onclick = () => sendReply(reply.text, reply.lcd);
    $('quick-replies').append(button);
  }
}
function showTranslation(event) {
  const translation = meaning(event.text, event.env);
  lastTranslation = translation.text;
  $('translation').textContent = translation.text;
  $('translation').dataset.urgent = String(translation.urgent);
  $('sign-detail').textContent = `${translation.gesture} · ${translation.env} · ${event.source === 'flex' ? 'hand shape' : 'motion'}`;
  $('replay').disabled = !voice.isSupported();
  renderQuickReplies(translation.replies);
  const card = $('gesture-guide').querySelector(`[data-gesture="${translation.key}"]`);
  for (const item of $('gesture-guide').children) item.dataset.active = String(item === card);
  clearTimeout(flashTimer); flashTimer = setTimeout(() => { for (const item of $('gesture-guide').children) item.dataset.active = 'false'; }, 2500);
}
function renderEnvironment(envId) {
  if (shownEnv === envId) return;
  shownEnv = envId;
  const env = environment(envId);
  for (const button of $('environments').children) button.setAttribute('aria-checked', String(button.dataset.env === env.id));
  $('guide-env').textContent = env.name;
  for (const item of $('gesture-guide').children) item.querySelector('.meaning').textContent = env.phrases[item.dataset.gesture].text;
  if ([...$('scenario').options].some((option) => option.value === env.id)) { $('scenario').value = env.id; renderPhrases(); }
}
function bendLabel(element, change, trigger) {
  const strong = document.createElement('strong'); strong.textContent = trigger;
  element.replaceChildren(`${change} / `, strong);
}
// Same rule as the firmware's handShape(): middle and ring closed, then index and pinky decide.
function handShape(pattern) {
  const [, index, middle, ring, pinky] = [...pattern].map((bit) => bit === '1');
  if (!middle || !ring) return null;
  if (index && pinky) return 'FIST';
  if (!index && pinky) return 'POINT';
  if (index && !pinky) return 'PINKY';
  return 'ROCK';
}
function renderHand() {
  const ready = state.useFlex && state.calibrated;
  const bendOf = (i) => (ready ? Math.min(1, Math.max(0, state.delta[i] / state.bendOn[i])) : 0);
  for (const finger of $('hand').querySelectorAll('.finger')) {
    const i = Number(finger.dataset.finger), bend = bendOf(i);
    finger.style.transform = `scaleY(${1 - 0.4 * bend})`;
    finger.dataset.bent = String(ready && state.pattern[i] === '1');
    const chip = $('finger-chips').children[i];
    chip.dataset.bent = finger.dataset.bent;
  }
  const shape = ready ? handShape(state.pattern) : null;
  $('hand-shape').textContent = state.job ? 'Calibrating…' : !state.useFlex ? 'Flex off' : !state.calibrated ? 'Not calibrated' : shape ? SHAPE_NAMES[shape] : /^.000/.test(state.pattern) ? 'Open hand' : 'No shape';
  $('hand-shape').dataset.shape = String(Boolean(shape));
  [...$('bend-rows').children].forEach((row, i) => {
    const live = row.querySelector('.bend-live'), input = row.querySelector('input');
    if (!bendDirty) input.value = state.bendOn[i];
    live.style.width = `${Math.min(100, (state.delta[i] / BEND_SCALE) * 100)}%`;
    live.dataset.bent = String(state.pattern[i] === '1');
    bendLabel(row.querySelector('.bend-value'), state.delta[i], input.value);
  });
  const speed = state.mpu ? Math.hypot(...state.gyro) : 0;
  $('speed').textContent = state.mpu ? `${Math.round(speed)}°/s` : 'MPU unavailable';
  $('speed-fill').style.width = `${Math.min(100, speed / 3)}%`;
  $('speed-fill').dataset.moving = String(speed > 90);
  const motion = state.motion;
  if (motion?.energy) $('motion-summary').textContent = motion.result ? `Last motion: ${GESTURES[motion.result]?.name ?? motion.result}` : 'Last motion not recognized. Try a bigger, cleaner movement.';
}
function addHistory(key, text, type, detail) {
  let item = rows.get(key);
  if (!item) {
    item = document.createElement('li'); item.dataset.type = type;
    const who = document.createElement('p'); who.className = 'who'; who.textContent = type === 'sign' ? 'Glove' : 'Reply';
    const message = document.createElement('p'); message.className = 'message'; message.textContent = text;
    const delivery = document.createElement('p'); delivery.className = 'delivery';
    item.append(who, message, delivery); $('history').prepend(item); rows.set(key, item);
    while (rows.size > 60) {
      const oldest = $('history').lastElementChild;
      for (const [id, row] of rows) if (row === oldest) { rows.delete(id); break; }
      oldest.remove();
    }
  }
  item.querySelector('.delivery').textContent = detail;
  $('history-empty').hidden = rows.size > 0;
  return item;
}
async function sendReply(text, override) {
  text = text.trim();
  if (!text || new TextEncoder().encode(text).length > 160) return feedback('This message is too long for the glove. Shorten it and try again.', true);
  const id = makeUid(), lcd = formatLcd(text, override);
  pending.set(id, { text, at: Date.now() });
  addHistory(id, text, 'reply', 'Sending…');
  try {
    await command('reply', { id, text, line1: lcd.lines[0], line2: lcd.lines[1], vib: vibFor(text) });
    if (pending.has(id)) {
      addHistory(id, text, 'reply', 'Accepted; waiting for the glove');
      feedback('Reply accepted. Waiting for the glove’s LCD result.');
    }
    $('reply-text').value = ''; preview();
  } catch (error) {
    // A lost HTTP response does not prove the queued command failed. A later
    // device acknowledgement can still replace this status.
    addHistory(id, text, 'reply', 'Delivery unconfirmed'); feedback(error.message, true);
  }
}
function receive(input) {
  const incoming = validateState(input);
  const restart = cursor.boot !== null && cursor.boot !== incoming.boot;
  if (restart) {
    for (const [id, reply] of pending) addHistory(id, reply.text, 'reply', 'Glove restarted; delivery unconfirmed');
    pending.clear();
  }
  if (!online) feedback('');
  state = incoming; lastPacket = Date.now(); retryDelay = 800;
  connection(true, state.job ? 'Glove connected · task in progress' : 'Glove connected');
  const accepted = consumeEvents(cursor, state); cursor = accepted.cursor;
  for (const event of accepted.events) {
    if (event.type === 'sign') {
      showTranslation(event);
      const translation = meaning(event.text, event.env);
      addHistory(`${state.boot}:${event.seq}`, translation.text, 'sign', `${translation.gesture} · ${translation.env}`);
    } else {
      const key = pending.has(event.requestId) || rows.has(event.requestId) ? event.requestId : `${state.boot}:${event.seq}`;
      addHistory(key, event.text, 'reply', replyDelivery(event));
      if (pending.has(event.requestId)) { pending.delete(event.requestId); feedback(replyDelivery(event), !event.lcd); }
    }
  }
  if (accepted.audible.length && voice.isUnlocked() && !voice.isMuted()) { const last = accepted.audible.at(-1); voice.speak(meaning(last.text, last.env).text); }
  const notice = `${state.notice}${state.remaining > 0 ? ` (${state.remaining})` : ''}`;
  if (displayedNotice !== notice) { $('device-notice').textContent = notice; displayedNotice = notice; }
  $('sensor-summary').textContent = `MPU ${state.mpu ? 'connected' : 'unavailable'} · LCD ${state.lcd ? 'connected' : 'unavailable'}`;
  $('pattern').textContent = state.pattern;
  fingerNames.forEach((_, index) => {
    const row = $('sensor-rows').children[index];
    row.children[2].textContent = state.flex[index]; row.children[3].textContent = Math.round(state.baseline[index]); row.children[4].textContent = state.delta[index];
  });
  const axes = (values) => values.map((v, i) => `${'XYZ'[i]} ${Number(v).toFixed(2)}`).join('   ');
  $('imu-values').textContent = state.mpu ? `Acceleration (m/s²): ${axes(state.acc)}\nGyroscope (°/s): ${axes(state.gyro)}` : 'MPU unavailable. Check SDA 21, SCL 22 and sensor power.';
  const motion = state.motion;
  $('motion-values').textContent = motion && (motion.swings || motion.energy) ? `Last motion: ${motion.result ? GESTURES[motion.result]?.name ?? motion.result : 'not recognized'}\nSwings ${motion.swings} (${Number(motion.rate ?? 0).toFixed(1)}/s) · turn ${Math.round(motion.turn)}° · tilt change ${Math.round(motion.tilt)}° · energy ${Math.round(motion.energy)}°/s` : 'No motion analysed yet.';
  // Ignore a snapshot taken before the glove applied a just-clicked environment.
  const waiting = requestedEnv && state.env !== requestedEnv.id && Date.now() - requestedEnv.at < 2000;
  if (!waiting) { requestedEnv = null; renderEnvironment(state.env); }
  renderHand();
  for (const [id, enabled, label] of [['live', state.live, 'Serial values'], ['debug', state.debug, 'Serial motion details']]) {
    $(id).textContent = `${label}: ${enabled ? 'on' : 'off'}`; $(id).setAttribute('aria-pressed', String(enabled));
  }
  if (!settingsDirty) { $('use-flex').checked = state.useFlex; $('use-motor').checked = state.useMotor; }
  availability();
}
function reconnect() {
  const token = ++generation;
  clearTimeout(retryTimer);
  if (socket) { socket.onclose = null; socket.close(); }
  connection(false, 'Connecting…');
  const ws = new WebSocket(`${location.protocol === 'https:' ? 'wss:' : 'ws:'}//${location.host}/ws`); socket = ws;
  ws.onmessage = (message) => {
    if (token !== generation) return;
    try { receive(JSON.parse(message.data)); } catch (error) { feedback(error.message, true); }
  };
  ws.onerror = () => ws.close();
  ws.onclose = () => {
    if (token !== generation) return;
    connection(false, 'Glove disconnected');
    retryTimer = setTimeout(reconnect, retryDelay); retryDelay = Math.min(8000, retryDelay * 2);
  };
  // Initial HTTP snapshot also gives an immediate, useful error on preview servers.
  fetch('/api/state', { signal: AbortSignal.timeout(5000), cache: 'no-store' })
    .then(async (response) => { if (!response.ok) throw new Error('No glove connected here. Open 192.168.4.1 after joining its Wi-Fi.'); return response.json(); })
    .then((data) => { if (token === generation) receive(data); })
    .catch((error) => { if (token === generation && !online) feedback(error.message, true); });
}
function preview() {
  const text = $('reply-text').value.trim();
  if (!text) { $('lcd-preview').textContent = 'Up to two lines on the glove’s display.'; return; }
  const lcd = formatLcd(text);
  $('lcd-preview').textContent = `${lcd.lines.filter(Boolean).join(' / ')}${lcd.truncated ? ' (shortened on LCD)' : ''}`;
}
function renderPhrases() {
  const query = $('phrase-search').value.toLowerCase();
  const selected = $('scenario').value;
  const phrases = selected === 'everyday' ? GENERIC : SCENARIOS.find((scenario) => scenario.id === selected)?.phrases || [];
  $('phrase-list').replaceChildren();
  for (const phrase of phrases.filter((phrase) => phrase.text.toLowerCase().includes(query))) {
    const button = document.createElement('button'); button.type = 'button'; button.textContent = phrase.text;
    button.onclick = () => { $('reply-text').value = phrase.text; preview(); $('reply-text').focus(); };
    $('phrase-list').append(button);
  }
}
function init() {
  fingerNames.forEach((name, index) => {
    const row = document.createElement('tr');
    for (const value of [name, pins[index], '—', '—', '—']) { const cell = document.createElement('td'); cell.textContent = value; row.append(cell); }
    $('sensor-rows').append(row);
  });
  for (const env of ENVIRONMENTS) {
    const button = document.createElement('button'); button.type = 'button'; button.textContent = env.name;
    button.dataset.env = env.id; button.setAttribute('role', 'radio'); button.setAttribute('aria-checked', 'false');
    // Switch the page immediately; the glove follows when connected and its state wins.
    button.onclick = () => { renderEnvironment(env.id); if (online) { requestedEnv = { id: env.id, at: Date.now() }; run('env', { value: env.id }); } };
    $('environments').append(button);
  }
  for (const name of fingerNames) {
    const chip = document.createElement('li'); chip.textContent = name; $('finger-chips').append(chip);
    const row = document.createElement('li'), label = document.createElement('span'), track = document.createElement('div');
    const live = document.createElement('span'), input = document.createElement('input'), value = document.createElement('span');
    label.textContent = name; track.className = 'bend-track'; live.className = 'bend-live'; value.className = 'bend-value';
    Object.assign(input, { type: 'range', min: 20, max: BEND_SCALE, step: 5, value: 100 });
    input.setAttribute('aria-label', `${name} bend trigger`);
    input.oninput = () => { bendDirty = true; bendLabel(value, state?.delta[fingerNames.indexOf(name)] ?? '—', input.value); availability(); };
    track.append(live, input); row.append(label, track, value); $('bend-rows').append(row);
  }
  for (const [key, gesture] of Object.entries(GESTURES)) {
    const item = document.createElement('li'); item.dataset.gesture = key; item.dataset.kind = gesture.kind;
    const name = document.createElement('span'); name.className = 'name'; name.textContent = gesture.name;
    const said = document.createElement('span'); said.className = 'meaning';
    const how = document.createElement('small'); how.textContent = gesture.how;
    item.append(name, said, how); $('gesture-guide').append(item);
  }
  for (const scenario of SCENARIOS) { const option = document.createElement('option'); option.value = scenario.id; option.textContent = scenario.name; $('scenario').append(option); }
  renderPhrases(); renderQuickReplies(DEFAULT_REPLIES); renderEnvironment('everyday');
  $('scenario').onchange = renderPhrases; $('phrase-search').oninput = renderPhrases;
  $('reconnect').onclick = reconnect;
  $('reply-form').onsubmit = (event) => { event.preventDefault(); sendReply($('reply-text').value); };
  $('reply-text').oninput = preview;
  $('calibrate').onclick = $('recalibrate').onclick = () => run('calibrate');
  $('save-bend').onclick = async () => {
    try { await command('bend', { values: [...$('bend-rows').querySelectorAll('input')].map((input) => Number(input.value)) }); bendDirty = false; availability(); }
    catch (error) { feedback(error.message, true); }
  };
  $('reset-bend').onclick = async () => {
    try { await command('bend', { reset: true }); bendDirty = false; availability(); }
    catch (error) { feedback(error.message, true); }
  }; $('cancel').onclick = () => run('cancel');
  $('live').onclick = () => run('live', { value: !state.live });
  $('debug').onclick = () => run('debug', { value: !state.debug });
  $('settings').oninput = () => { settingsDirty = true; };
  $('settings').onsubmit = async (event) => {
    event.preventDefault();
    try { await command('settings', { useFlex: $('use-flex').checked, useMotor: $('use-motor').checked }); settingsDirty = false; }
    catch (error) { feedback(error.message, true); }
  };
  $('clear').onclick = () => { rows.clear(); $('history').replaceChildren(); $('history-empty').hidden = true; $('history-empty').textContent = 'Conversation cleared on this screen.'; $('history-empty').hidden = false; };
  $('sound').disabled = !voice.isSupported();
  $('sound').onclick = () => {
    if (!voice.isUnlocked()) { voice.unlock(); if (voice.isMuted()) voice.toggleMute(); }
    else voice.toggleMute();
    const on = !voice.isMuted(); $('sound').textContent = on ? 'Voice on' : 'Voice off'; $('sound').setAttribute('aria-pressed', String(on));
  };
  $('replay').onclick = () => { voice.unlock(); if (voice.isMuted()) voice.toggleMute(); voice.speak(lastTranslation); $('sound').textContent = 'Voice on'; $('sound').setAttribute('aria-pressed', 'true'); };
  setInterval(() => {
    if (online && Date.now() - lastPacket > 3500) { connection(false, 'Connection interrupted'); socket?.close(); }
    for (const [id, reply] of pending) if (Date.now() - reply.at > 8000) {
      addHistory(id, reply.text, 'reply', 'Delivery unconfirmed; check the glove');
      // Keep the row so a late acknowledgement still corrects its status.
      pending.delete(id);
    }
  }, 1000);
  reconnect();
}
init();

</script>
</body>
</html>
)SBWEB";
// END GENERATED WEB

namespace sb {
// BEGIN GENERATED GESTURES
enum Gesture : int { G_FIST, G_POINT, G_PINKY, G_ROCK, G_WAVE, G_FLIP, G_NOD, G_SHAKE, GESTURE_N };
constexpr int ENV_N = 5;
const char* gestureNames[GESTURE_N] = {"FIST", "POINT", "PINKY", "ROCK", "WAVE", "FLIP", "NOD", "SHAKE"};
const char* envIds[ENV_N] = {"everyday", "hospital", "market", "restaurant", "classroom"};
const char* envLcd[ENV_N] = {"EVERYDAY MODE", "HOSPITAL MODE", "MARKET MODE", "RESTAURANT MODE", "CLASSROOM MODE"};
const char* phraseLcd[ENV_N][GESTURE_N][2] = {
  {{"YES.", ""}, {"I HAVE A", "QUESTION."}, {"WHERE IS THE", "WASHROOM?"}, {"I LOVE IT!", ""}, {"HELLO!", ""}, {"THANK YOU.", ""}, {"PLEASE REPEAT", "THAT."}, {"EMERGENCY!", "PLEASE HELP ME."}},
  {{"I AM IN PAIN.", ""}, {"IT HURTS HERE.", ""}, {"I NEED THE", "WASHROOM."}, {"I FEEL BETTER", "NOW."}, {"NURSE, PLEASE", "COME."}, {"THANK YOU,", "DOCTOR."}, {"I NEED WATER.", ""}, {"EMERGENCY! CALL", "A DOCTOR."}},
  {{"YES, I'LL BUY", "IT."}, {"HOW MUCH IS", "THIS?"}, {"DO YOU HAVE A", "SMALLER ONE?"}, {"GOOD PRICE,", "DEAL!"}, {"EXCUSE ME!", ""}, {"CAN I GET A", "DISCOUNT?"}, {"CAN I PAY BY", "UPI?"}, {"EMERGENCY!", "PLEASE HELP ME."}},
  {{"YES, PLEASE.", ""}, {"I WANT THIS ONE.", ""}, {"WHERE IS THE", "WASHROOM?"}, {"THE FOOD IS", "GREAT!"}, {"WAITER, PLEASE!", ""}, {"THE BILL,", "PLEASE."}, {"WATER, PLEASE.", ""}, {"EMERGENCY!", "PLEASE HELP ME."}},
  {{"YES, I'M HERE.", ""}, {"I HAVE A", "QUESTION."}, {"MAY I GO TO THE", "WASHROOM?"}, {"I UNDERSTAND.", ""}, {"GOOD MORNING!", ""}, {"THANK YOU,", "TEACHER."}, {"PLEASE REPEAT", "THAT."}, {"EMERGENCY!", "PLEASE HELP ME."}}
};
// END GENERATED GESTURES
constexpr int WINDOW = 75, PRE = 10, SAMPLE_MS = 20, FLEX_SAMPLE_MS = 100;
constexpr int flexPins[5] = {33, 35, 36, 34, 32};
// Per-finger change from the calibrated reading that counts as bent. Adjustable
// from the website and saved; a finger reads straight again below two thirds of it.
constexpr int DEFAULT_BEND_ON[5] = {150, 100, 100, 130, 110};
constexpr int BEND_MIN = 20, BEND_MAX = 1000;
int bendOn[5] = {150, 100, 100, 130, 110};
constexpr int F_INDEX = 1, F_MIDDLE = 2, F_RING = 3, F_PINKY = 4;
// Deliberately loose thresholds (degrees, degrees/second, milliseconds) so demo gestures trigger easily.
constexpr float MOVE_START = 90, REST_SPEED = 35, STILL_SPEED = 80;
// A direction change only counts when the speed passes this share of the movement's peak,
// so the small bounce after a nod or flip is not mistaken for another swing.
constexpr float SWING_MIN = 50, SWING_SHARE = 0.35f;
constexpr float FLIP_TILT = 70, FLIP_TURN = 120, SHAKE_ENERGY = 150, SHAKE_RATE = 5;
constexpr int SHAKE_SWINGS = 5, HOLD_MS = 400, REST_MS = 250, COOLDOWN_MS = 800;
// A movement ends once the hand has been still this many samples (after a minimum length).
constexpr int MIN_MOVE_SAMPLES = 12, END_QUIET_SAMPLES = 8;
constexpr int MOTOR_PIN = 26;
TwoWire lcdWire(1);
Preferences prefs;
httpd_handle_t server = nullptr;
QueueHandle_t commandQueue;
SemaphoreHandle_t snapshotMutex;
std::atomic<bool> broadcastPending{false};
String snapshot;

bool useFlex = true, useMotor = false;
bool liveOutput = true, debugOn = false;
bool mpuOK = false, lcdOK = false, lcdError = false;
bool flexReady = false, imuReady = false;
uint8_t lcdAddress = 0, mask = 0;
int env = 0;
int raw[5] = {}, delta[5] = {};
float baseline[5] = {}, filtered[5] = {};
bool bent[5] = {};
float acc[3] = {}, gyr[3] = {}, rawGyr[3] = {}, gyroBias[3] = {};
float preA[PRE][3] = {}, preG[PRE][3] = {};
float moveA[WINDOW][3] = {}, moveG[WINDOW][3] = {};
int preIndex = 0, preCount = 0, captureIndex = 0, quietSamples = 0;
bool capturing = false, motionArmed = false;
uint32_t restSince = 0, cooldownAt = 0;
int shapeCandidate = -1, heldShape = -1, lastGesture = -1;
uint32_t candidateAt = 0;
struct MotionInfo { int swings; float rate, turn, tilt, energy; int result; } lastMotion = {0, 0, 0, 0, 0, -1};
uint32_t lastSample = 0, lastFlexSample = 0, lastSerial = 0, lastPublish = 0, lastRetry = 0, lastLCD = 0;
char notice[160] = "Starting";
char bootId[12];
uint32_t lastSignAt = 0, replyAt = 0, envAt = 0;
char replyLines[2][17] = {};
bool replyActive = false;

struct Event {
  uint32_t seq;
  char type[8], text[161], source[8], requestId[40], env[12];
  bool lcd, haptic;
};
constexpr int HISTORY = 12;
Event history[HISTORY] = {};
uint32_t eventSeq = 0;
int historyNext = 0, historyCount = 0;

// HTTP callbacks only enqueue. Sensor, flash and LCD access stays on loop().
struct Command {
  char op[20], id[40], text[161], lines[2][17], vib[9];
  int index;
  bool value, flex, motor, reset;
  int bend[5];
};
enum class Job { Idle, CalPrep, CalSample };
Job job = Job::Idle;
int sampleCount = 0, imuSamples = 0;
uint32_t jobAt = 0;
float flexSums[5] = {}, gyroSums[3] = {};
float maxCalibrationGyro = 0;

struct Vibration {
  uint16_t pulses[11];
  uint8_t count = 0, index = 0;
  uint32_t at = 0;
  bool active = false;
} vibration;

void setNotice(const char* text) {
  strlcpy(notice, text, sizeof(notice));
  Serial.println(text);
}
float magnitude(const float v[3]) { return sqrtf(v[0]*v[0] + v[1]*v[1] + v[2]*v[2]); }
void normalize(float v[3]) {
  float n = magnitude(v);
  if (n > 0.00001f) for (int k = 0; k < 3; ++k) v[k] /= n;
}
void maskText(uint8_t value, char text[6]) {
  for (int i = 0; i < 5; ++i) text[i] = value & (1 << i) ? '1' : '0';
  text[5] = 0;
}
bool writeMPU(uint8_t reg, uint8_t value) {
  Wire.beginTransmission(0x68); Wire.write(reg); Wire.write(value);
  return Wire.endTransmission() == 0;
}
bool initMPU() {
  Wire.beginTransmission(0x68); Wire.write(0x75);
  if (Wire.endTransmission(false) != 0 || Wire.requestFrom(uint8_t(0x68), uint8_t(1)) != 1) return false;
  int id = Wire.read();
  if (id != 0x70 && id != 0x68) return false;
  return writeMPU(0x6B, 0) && writeMPU(0x1C, 0) && writeMPU(0x1B, 0x08) && writeMPU(0x1A, 3);
}
bool readMPU() {
  Wire.beginTransmission(0x68); Wire.write(0x3B);
  if (Wire.endTransmission(false) != 0 || Wire.requestFrom(uint8_t(0x68), uint8_t(14)) != 14) return false;
  int16_t values[7];
  for (int i = 0; i < 7; ++i) {
    uint8_t hi = Wire.read(), lo = Wire.read();
    values[i] = int16_t((uint16_t(hi) << 8) | lo);
  }
  for (int k = 0; k < 3; ++k) {
    acc[k] = values[k] / 16384.0f;
    rawGyr[k] = values[k + 4] / 65.5f;
    gyr[k] = rawGyr[k] - gyroBias[k];
  }
  return true;
}
void readFlex() {
  mask = 0;
  for (int i = 0; i < 5; ++i) {
    analogRead(flexPins[i]);
    int sum = 0;
    for (int n = 0; n < 4; ++n) sum += analogRead(flexPins[i]);
    raw[i] = sum / 4;
    filtered[i] = 0.75f * filtered[i] + 0.25f * raw[i];
    delta[i] = abs(int(filtered[i] - baseline[i]));
    if (!bent[i] && delta[i] >= bendOn[i]) bent[i] = true;
    else if (bent[i] && delta[i] <= bendOn[i] * 2 / 3) bent[i] = false;
    if (bent[i]) mask |= 1 << i;
  }
}
// Index, middle, ring and pinky decide a hand shape; the thumb is not used.
// Middle and ring must both be closed, so a relaxed half-open hand is never a shape.
int handShape() {
  bool i = bent[F_INDEX], m = bent[F_MIDDLE], r = bent[F_RING], p = bent[F_PINKY];
  if (!m || !r) return -1;
  if (i && p) return G_FIST;
  if (!i && p) return G_POINT;
  if (i && !p) return G_PINKY;
  return G_ROCK;
}
void lcdExpander(uint8_t data) {
  lcdWire.beginTransmission(lcdAddress); lcdWire.write(data | 0x08);
  if (lcdWire.endTransmission() != 0) lcdError = true;
}
void lcdNibble(uint8_t value, bool rs) {
  uint8_t data = (value << 4) | (rs ? 1 : 0);
  lcdExpander(data); delayMicroseconds(2);
  lcdExpander(data | 4); delayMicroseconds(2);
  lcdExpander(data); delayMicroseconds(100);
}
void lcdSend(uint8_t value, bool rs) { lcdNibble(value >> 4, rs); lcdNibble(value & 15, rs); }
void lcdCommand(uint8_t value) { lcdSend(value, false); if (value < 3) delay(2); }
bool initLCD() {
  lcdError = false;
  lcdAddress = 0;
  for (uint8_t address = 0x20; address <= 0x3F; ++address) {
    lcdWire.beginTransmission(address);
    if (lcdWire.endTransmission() == 0) { lcdAddress = address; break; }
  }
  if (!lcdAddress) return false;
  delay(50);
  lcdNibble(3, false); delay(5); lcdNibble(3, false); delayMicroseconds(150);
  lcdNibble(3, false); delayMicroseconds(150); lcdNibble(2, false);
  lcdCommand(0x28); lcdCommand(0x08); lcdCommand(1); lcdCommand(6); lcdCommand(0x0C);
  return !lcdError;
}
void lcdLine(int row, const char* text) {
  if (!lcdOK) return;
  lcdCommand(row ? 0xC0 : 0x80);
  char line[17]; snprintf(line, sizeof(line), "%-16.16s", text);
  for (int i = 0; i < 16; ++i) lcdSend(line[i], true);
}
void lcdWrap(const char* text, char lines[2][17]) {
  char clean[161]; int n = 0;
  for (int i = 0; text[i] && n < 160; ++i) {
    unsigned char c = text[i];
    if (c >= 32 && c < 127) clean[n++] = toupper(c);
  }
  clean[n] = 0;
  int split = min(n, 16);
  if (n > 16) for (int i = 16; i > 0; --i) if (clean[i] == ' ') { split = i; break; }
  snprintf(lines[0], 17, "%.*s", split, clean);
  int start = split;
  while (clean[start] == ' ') ++start;
  strlcpy(lines[1], clean + start, 17);
  if (n - start > 16) { lines[1][14] = '.'; lines[1][15] = '.'; lines[1][16] = 0; }
}
void updateLCD() {
  if (!lcdOK) return;
  char lines[2][17] = {};
  uint32_t now = millis();
  if (replyActive && now - replyAt < 10000) {
    memcpy(lines, replyLines, sizeof(lines));
  } else if (job != Job::Idle) {
    strlcpy(lines[0], "HAND FLAT", 17); strlcpy(lines[1], "KEEP STILL", 17);
  } else if (lastGesture >= 0 && now - lastSignAt < 4000) {
    strlcpy(lines[0], phraseLcd[env][lastGesture][0], 17); strlcpy(lines[1], phraseLcd[env][lastGesture][1], 17);
  } else if (envAt && now - envAt < 2500) {
    strlcpy(lines[0], "MODE CHANGED", 17); strlcpy(lines[1], envLcd[env], 17);
  } else {
    strlcpy(lines[0], envLcd[env], 17); strlcpy(lines[1], "192.168.4.1", 17);
  }
  lcdLine(0, lines[0]); lcdLine(1, lines[1]);
}
void startVibration(const char* code) {
  digitalWrite(MOTOR_PIN, LOW); vibration.active = false;
  if (!useMotor) return;
  const uint16_t ack[] = {150}, yes[] = {150,150,150}, no[] = {800};
  const uint16_t msg[] = {150,150,150,150,150};
  const uint16_t urgent[] = {500,120,150,120,500,120,150,120,500,120,150};
  const uint16_t* pulses = msg; size_t count = 5;
  if (!strcmp(code, "ACK")) { pulses = ack; count = 1; }
  else if (!strcmp(code, "YES")) { pulses = yes; count = 3; }
  else if (!strcmp(code, "NO")) { pulses = no; count = 1; }
  else if (!strcmp(code, "URGENT")) { pulses = urgent; count = 11; }
  memcpy(vibration.pulses, pulses, count * sizeof(uint16_t));
  vibration.count = count; vibration.index = 0; vibration.at = millis(); vibration.active = true;
  digitalWrite(MOTOR_PIN, HIGH);
}
void tickVibration() {
  if (!vibration.active || millis() - vibration.at < vibration.pulses[vibration.index]) return;
  ++vibration.index; vibration.at = millis();
  vibration.active = vibration.index < vibration.count;
  digitalWrite(MOTOR_PIN, vibration.active && vibration.index % 2 == 0 ? HIGH : LOW);
}
void addEvent(const char* type, const char* text, const char* source, const char* requestId = "", bool lcd = false, bool haptic = false) {
  Event& e = history[historyNext]; e = {};
  e.seq = ++eventSeq; strlcpy(e.type, type, sizeof(e.type)); strlcpy(e.text, text, sizeof(e.text));
  strlcpy(e.source, source, sizeof(e.source)); strlcpy(e.requestId, requestId, sizeof(e.requestId));
  strlcpy(e.env, envIds[env], sizeof(e.env));
  e.lcd = lcd; e.haptic = haptic;
  historyNext = (historyNext + 1) % HISTORY; historyCount = min(historyCount + 1, HISTORY);
}
// Events carry the gesture key plus the environment; the website shows the full phrase.
void showGesture(int g, const char* source) {
  lastGesture = g; lastSignAt = millis(); replyActive = false;
  Serial.printf(">>> RECOGNIZED: %s <<<\n", gestureNames[g]);
  Serial.printf("MEANING (%s): %s %s\n", envIds[env], phraseLcd[env][g][0], phraseLcd[env][g][1]);
  addEvent("sign", gestureNames[g], source); updateLCD();
}
void resetRecognition() {
  shapeCandidate = heldShape = -1; candidateAt = 0;
  capturing = false; captureIndex = 0; preIndex = preCount = 0;
  motionArmed = false; restSince = 0; cooldownAt = millis();
}
void loadSettings() {
  useFlex = prefs.getBool("useFlex", true); useMotor = prefs.getBool("useMotor", false);
  env = prefs.getUChar("env", 0);
  int saved[5];
  bool valid = prefs.getBytesLength("bendOn") == sizeof(saved) && prefs.getBytes("bendOn", saved, sizeof(saved)) == sizeof(saved);
  for (int i = 0; valid && i < 5; ++i) valid = saved[i] >= BEND_MIN && saved[i] <= BEND_MAX;
  memcpy(bendOn, valid ? saved : DEFAULT_BEND_ON, sizeof(bendOn));
  if (env >= ENV_N) env = 0;
}
void setEnvironment(int index) {
  env = index; envAt = millis(); lastGesture = -1; replyActive = false;
  prefs.putUChar("env", env);
  char message[64]; snprintf(message, sizeof(message), "Environment: %s", envIds[env]);
  setNotice(message); updateLCD();
}
void startCalibration() {
  resetRecognition(); job = Job::CalPrep; jobAt = millis(); sampleCount = imuSamples = 0;
  memset(flexSums, 0, sizeof(flexSums)); memset(gyroSums, 0, sizeof(gyroSums)); maxCalibrationGyro = 0;
  setNotice("Calibration: keep fingers straight and hand flat and still. Sampling starts in 2 seconds.");
}
void finishJob(const char* text) {
  job = Job::Idle; resetRecognition(); setNotice(text);
}
void beginCapture() {
  captureIndex = quietSamples = 0;
  for (int i = 0; i < PRE; ++i) {
    int j = (preIndex + i) % PRE;
    memcpy(moveA[i], preA[j], sizeof(acc)); memcpy(moveG[i], preG[j], sizeof(gyr));
    ++captureIndex;
  }
  capturing = true;
}
// Rule-based motion classes that do not depend on how the MPU is mounted. Each
// movement is cut from rest to rest, then told apart by clearly different traits:
//   shake = many fast direction changes, flip = ends turned over (gravity moved),
//   wave = back and forth twice or more, nod = out and back exactly once.
int classifyMotion(MotionInfo& m) {
  int len = captureIndex, end = quietSamples >= END_QUIET_SAMPLES ? len - quietSamples : len;
  int tail = min(END_QUIET_SAMPLES, len - PRE);
  float startG[3] = {}, endG[3] = {}, net[3] = {}, rms[3] = {}, peak = 0;
  for (int i = 0; i < PRE; ++i) for (int k = 0; k < 3; ++k) startG[k] += moveA[i][k];
  for (int i = len - tail; i < len; ++i) for (int k = 0; k < 3; ++k) endG[k] += moveA[i][k];
  normalize(startG); normalize(endG);
  float dot = constrain(startG[0]*endG[0] + startG[1]*endG[1] + startG[2]*endG[2], -1.0f, 1.0f);
  m.tilt = acosf(dot) * 57.2958f;
  int moving = max(1, end - PRE);
  for (int i = 0; i < len; ++i) for (int k = 0; k < 3; ++k) net[k] += moveG[i][k] * SAMPLE_MS / 1000.0f;
  for (int i = PRE; i < end; ++i) for (int k = 0; k < 3; ++k) rms[k] += moveG[i][k] * moveG[i][k];
  float energy = 0;
  int axis = 0;
  for (int k = 0; k < 3; ++k) { energy += rms[k]; if (rms[k] > rms[axis]) axis = k; }
  m.energy = sqrtf(energy / moving);
  m.turn = fabsf(net[axis]);
  for (int i = PRE; i < end; ++i) peak = max(peak, fabsf(moveG[i][axis]));
  float swingSpeed = max(SWING_MIN, SWING_SHARE * peak);
  int swings = 0, direction = 0;
  for (int i = PRE; i < end; ++i) {
    float v = moveG[i][axis];
    int next = v > swingSpeed ? 1 : v < -swingSpeed ? -1 : 0;
    if (next && next != direction) { if (direction) ++swings; direction = next; }
  }
  m.swings = swings;
  m.rate = swings * 1000.0f / (moving * SAMPLE_MS);
  if (swings >= SHAKE_SWINGS && m.rate >= SHAKE_RATE && m.energy >= SHAKE_ENERGY) return G_SHAKE;
  // A flex shape at the end means the hand was moving into a sign, not making a motion.
  if (useFlex && flexReady && handShape() >= 0) return -1;
  if (swings <= 1 && (m.tilt >= FLIP_TILT || m.turn >= FLIP_TURN)) return G_FLIP;
  if (swings >= 2) return G_WAVE;
  if (swings == 1) return G_NOD;
  return -1;
}
void finishCapture() {
  capturing = false; motionArmed = false; restSince = 0; cooldownAt = millis();
  MotionInfo m = {};
  m.result = classifyMotion(m);
  lastMotion = m;
  if (debugOn) Serial.printf("MOTION swings=%d rate=%.1f/s turn=%.0f tilt=%.0f energy=%.0f -> %s\n", m.swings, m.rate, m.turn, m.tilt, m.energy, m.result >= 0 ? gestureNames[m.result] : "NONE");
  if (m.result >= 0) {
    showGesture(m.result, "motion");
    shapeCandidate = heldShape = -1;
  }
}
void tickJob(bool flexSampled) {
  uint32_t now = millis();
  switch (job) {
    case Job::CalPrep:
      if (now - jobAt >= 2000) { job = Job::CalSample; setNotice("Sampling: keep fingers straight and hand still."); }
      break;
    case Job::CalSample:
      if (flexSampled) {
        for (int i = 0; i < 5; ++i) flexSums[i] += raw[i];
        ++sampleCount;
      }
      if (mpuOK) {
        for (int k = 0; k < 3; ++k) gyroSums[k] += rawGyr[k];
        maxCalibrationGyro = max(maxCalibrationGyro, magnitude(rawGyr)); ++imuSamples;
      }
      if (sampleCount >= 60) {
        if (imuSamples >= 30 && maxCalibrationGyro > 45) { finishJob("Calibration rejected: hand moved. Recalibrate while still."); break; }
        for (int i = 0; i < 5; ++i) { baseline[i] = filtered[i] = flexSums[i]/sampleCount; delta[i] = 0; bent[i] = false; }
        mask = 0; flexReady = true;
        if (imuSamples >= 30) { for (int k = 0; k < 3; ++k) gyroBias[k] = gyroSums[k]/imuSamples; imuReady = true; }
        finishJob(imuReady && mpuOK ? "Calibration complete. Show a gesture." : "Flex calibrated. MPU unavailable; check wiring, then recalibrate for motion.");
      }
      break;
    default: break;
  }
}
void tickRecognition() {
  uint32_t now = millis();
  if (capturing) {
    if (!mpuOK) { capturing = false; motionArmed = false; restSince = 0; cooldownAt = now; return; }
    memcpy(moveA[captureIndex], acc, sizeof(acc)); memcpy(moveG[captureIndex], gyr, sizeof(gyr));
    quietSamples = magnitude(gyr) < REST_SPEED ? quietSamples + 1 : 0;
    if (++captureIndex >= WINDOW || (captureIndex >= PRE + MIN_MOVE_SAMPLES && quietSamples >= END_QUIET_SAMPLES)) finishCapture();
    return;
  }
  if (job != Job::Idle) return;
  float speed = mpuOK ? magnitude(gyr) : 0;
  int shape = useFlex && flexReady && speed < STILL_SPEED ? handShape() : -1;
  if (shape != shapeCandidate) { shapeCandidate = shape; candidateAt = now; heldShape = -1; }
  if (shape >= 0 && heldShape != shape && now - candidateAt >= HOLD_MS) { heldShape = shape; showGesture(shape, "flex"); }
  if (!mpuOK || !imuReady) { restSince = 0; motionArmed = false; return; }
  if (speed < REST_SPEED) {
    if (!restSince) restSince = now;
    if (now - restSince >= REST_MS && now - cooldownAt >= COOLDOWN_MS) motionArmed = true;
  } else restSince = 0;
  if (motionArmed && preCount >= PRE && speed > MOVE_START) { beginCapture(); motionArmed = false; }
}
void printReadings() {
  char bits[6]; maskText(mask, bits);
  Serial.printf("FLEX  (T I M R P): %d | %d | %d | %d | %d\n", raw[0],raw[1],raw[2],raw[3],raw[4]);
  Serial.printf("DELTA (T I M R P): %d | %d | %d | %d | %d\n", delta[0],delta[1],delta[2],delta[3],delta[4]);
  Serial.printf("BENT PATTERN: %s\n", bits);
  if (mpuOK) {
    Serial.printf("ACC: X=%.2f Y=%.2f Z=%.2f\n", acc[0]*9.80665f, acc[1]*9.80665f, acc[2]*9.80665f);
    Serial.printf("GYRO: X=%.2f Y=%.2f Z=%.2f\n", gyr[0], gyr[1], gyr[2]);
  }
  Serial.printf("STATUS: MPU=%s LCD=%s\n", mpuOK ? "OK" : "FAIL", lcdOK && !lcdError ? "OK" : "FAIL");
}
void printStatus() {
  Serial.printf("Environment: %s (e1..e%d to switch)\n", envIds[env], ENV_N);
  for (int g = 0; g < GESTURE_N; ++g) Serial.printf("%-6s -> %s %s\n", gestureNames[g], phraseLcd[env][g][0], phraseLcd[env][g][1]);
  Serial.printf("Wi-Fi %s / %s; http://192.168.4.1\n", AP_SSID, AP_PASSWORD);
}
void execute(const Command& c) {
  if (!strcmp(c.op, "reply")) {
    if (c.lines[0][0] || c.lines[1][0]) memcpy(replyLines, c.lines, sizeof(replyLines)); else lcdWrap(c.text, replyLines);
    replyActive = true; replyAt = millis(); updateLCD(); startVibration(c.vib);
    bool displayed = lcdOK && !lcdError;
    addEvent("reply", c.text, "partner", c.id, displayed, useMotor);
    Serial.printf("ACK|%s|LCD=%s\n", c.id, displayed ? "OK" : "FAIL");
    setNotice(displayed ? "Reply written to the LCD." : "Reply received; LCD unavailable. Check its wiring.");
  } else if (!strcmp(c.op, "calibrate")) {
    if (job == Job::Idle) startCalibration(); else setNotice("Finish or cancel the current task first.");
  } else if (!strcmp(c.op, "env")) setEnvironment(c.index);
  else if (!strcmp(c.op, "cancel")) finishJob("Task cancelled. Previous calibration retained.");
  else if (!strcmp(c.op, "live")) { liveOutput = c.value; Serial.printf("Live readings: %s\n", liveOutput ? "ON" : "OFF"); }
  else if (!strcmp(c.op, "debug")) { debugOn = c.value; Serial.printf("Debug: %s\n", debugOn ? "ON" : "OFF"); }
  else if (!strcmp(c.op, "settings")) {
    if (job != Job::Idle) { setNotice("Finish or cancel the current task before changing sensors."); return; }
    useFlex = c.flex; useMotor = c.motor;
    prefs.putBool("useFlex", useFlex); prefs.putBool("useMotor", useMotor);
    if (!useMotor) { vibration.active = false; digitalWrite(MOTOR_PIN, LOW); }
    resetRecognition(); setNotice("Sensor settings saved.");
  } else if (!strcmp(c.op, "bend")) {
    memcpy(bendOn, c.reset ? DEFAULT_BEND_ON : c.bend, sizeof(bendOn));
    prefs.putBytes("bendOn", bendOn, sizeof(bendOn));
    setNotice(c.reset ? "Bend triggers reset to defaults." : "Bend triggers saved.");
  } else if (!strcmp(c.op, "status")) printStatus();
}
void serialInput() {
  static char line[192]; static size_t used = 0; static bool overflow = false;
  while (Serial.available()) {
    char ch = Serial.read();
    if (ch == '\r' || ch == '\n') {
      if (overflow) { setNotice("Serial command too long; discarded."); overflow = false; used = 0; continue; }
      line[used] = 0;
      if (!used) continue;
      used = 0; Command c = {};
      if (!strcmp(line, "p")) { strlcpy(c.op, "live", sizeof(c.op)); c.value = !liveOutput; }
      else if (!strcmp(line, "d")) { strlcpy(c.op, "debug", sizeof(c.op)); c.value = !debugOn; }
      else if (!strcmp(line, "c")) strlcpy(c.op, "calibrate", sizeof(c.op));
      else if (!strcmp(line, "q")) strlcpy(c.op, "cancel", sizeof(c.op));
      else if (!strcmp(line, "s")) strlcpy(c.op, "status", sizeof(c.op));
      else if (strlen(line) == 2 && line[0] == 'e' && line[1] >= '1' && line[1] < '1' + ENV_N) { strlcpy(c.op,"env",sizeof(c.op)); c.index = line[1]-'1'; }
      else if (!strncmp(line, "reply ", 6)) { strlcpy(c.op,"reply",sizeof(c.op)); strlcpy(c.text,line+6,sizeof(c.text)); strlcpy(c.id,"serial",sizeof(c.id)); strlcpy(c.vib,"MSG",sizeof(c.vib)); }
      else { Serial.println("Commands + Enter: p values, d motion details, c calibrate, s status, e1..e5 environment, q cancel, reply TEXT"); continue; }
      execute(c);
    } else if (!overflow) {
      if (used < sizeof(line)-1) line[used++] = ch; else overflow = true;
    }
  }
}

// Snapshot is copied under a mutex. HTTP never reads live sensor data.
void jsonBool(cJSON* root, const char* key, bool value) { cJSON_AddBoolToObject(root, key, value); }
void addNumbers(cJSON* root, const char* key, const float* values, int count, float scale = 1) {
  cJSON* arr = cJSON_AddArrayToObject(root, key);
  for (int i = 0; i < count; ++i) cJSON_AddItemToArray(arr, cJSON_CreateNumber(values[i]*scale));
}
void addInts(cJSON* root, const char* key, const int* values, int count) {
  cJSON* arr = cJSON_AddArrayToObject(root, key);
  for (int i = 0; i < count; ++i) cJSON_AddItemToArray(arr, cJSON_CreateNumber(values[i]));
}
void publishState() {
  cJSON* root = cJSON_CreateObject(); if (!root) return;
  cJSON_AddStringToObject(root, "type", "state"); cJSON_AddStringToObject(root, "boot", bootId);
  cJSON_AddNumberToObject(root,"uptime",millis()); cJSON_AddNumberToObject(root,"heap",ESP.getFreeHeap());
  cJSON_AddStringToObject(root,"notice",notice); cJSON_AddNumberToObject(root,"job",int(job));
  cJSON_AddNumberToObject(root,"remaining", job == Job::CalPrep ? max(0, 2-int((millis()-jobAt)/1000)) : 0);
  jsonBool(root,"mpu",mpuOK); jsonBool(root,"lcd",lcdOK && !lcdError);
  jsonBool(root,"calibrated",flexReady); jsonBool(root,"imuCalibrated",imuReady);
  jsonBool(root,"live",liveOutput); jsonBool(root,"debug",debugOn);
  jsonBool(root,"useFlex",useFlex); jsonBool(root,"useMotor",useMotor);
  addInts(root,"bendOn",bendOn,5);
  cJSON_AddStringToObject(root,"env",envIds[env]);
  cJSON_AddStringToObject(root,"ip",WiFi.softAPIP().toString().c_str());
  cJSON_AddStringToObject(root,"stationIp",WiFi.status() == WL_CONNECTED ? WiFi.localIP().toString().c_str() : "");
  char bits[6]; maskText(mask,bits); cJSON_AddStringToObject(root,"pattern",bits);
  addInts(root,"flex",raw,5); addInts(root,"delta",delta,5); addNumbers(root,"baseline",baseline,5);
  addNumbers(root,"acc",acc,3,9.80665f); addNumbers(root,"gyro",gyr,3);
  cJSON* motion = cJSON_AddObjectToObject(root,"motion");
  cJSON_AddNumberToObject(motion,"swings",lastMotion.swings); cJSON_AddNumberToObject(motion,"rate",lastMotion.rate); cJSON_AddNumberToObject(motion,"turn",lastMotion.turn);
  cJSON_AddNumberToObject(motion,"tilt",lastMotion.tilt); cJSON_AddNumberToObject(motion,"energy",lastMotion.energy);
  cJSON_AddStringToObject(motion,"result",lastMotion.result >= 0 ? gestureNames[lastMotion.result] : "");
  cJSON* events = cJSON_AddArrayToObject(root,"events");
  for(int n=0;n<historyCount;++n) {
    const Event& e = history[(historyNext-historyCount+n+HISTORY)%HISTORY];
    cJSON* item = cJSON_CreateObject();
    cJSON_AddNumberToObject(item,"seq",e.seq); cJSON_AddStringToObject(item,"type",e.type);
    cJSON_AddStringToObject(item,"text",e.text); cJSON_AddStringToObject(item,"source",e.source);
    cJSON_AddStringToObject(item,"env",e.env);
    cJSON_AddStringToObject(item,"requestId",e.requestId); jsonBool(item,"lcd",e.lcd); jsonBool(item,"haptic",e.haptic);
    cJSON_AddItemToArray(events,item);
  }
  char* encoded = cJSON_PrintUnformatted(root);
  if(encoded) { xSemaphoreTake(snapshotMutex,portMAX_DELAY); snapshot = encoded; xSemaphoreGive(snapshotMutex); cJSON_free(encoded); }
  cJSON_Delete(root);
}
String getSnapshot() {
  xSemaphoreTake(snapshotMutex,portMAX_DELAY); String copy = snapshot; xSemaphoreGive(snapshotMutex); return copy;
}
void broadcast(void*) {
  String json = getSnapshot();
  size_t count = 7; int clients[7];
  if (httpd_get_client_list(server,&count,clients)==ESP_OK) for(size_t i=0;i<count;++i) {
    if(httpd_ws_get_fd_info(server,clients[i])!=HTTPD_WS_CLIENT_WEBSOCKET) continue;
    httpd_ws_frame_t frame = {}; frame.type=HTTPD_WS_TYPE_TEXT; frame.payload=(uint8_t*)json.c_str(); frame.len=json.length();
    if(httpd_ws_send_frame_async(server,clients[i],&frame)!=ESP_OK) httpd_sess_trigger_close(server,clients[i]);
  }
  broadcastPending.store(false);
}
esp_err_t homeHandler(httpd_req_t* req) {
  httpd_resp_set_type(req,"text/html; charset=utf-8"); httpd_resp_set_hdr(req,"Cache-Control","no-cache");
  return httpd_resp_send(req,WEB_PAGE,sizeof(WEB_PAGE)-1);
}
esp_err_t stateHandler(httpd_req_t* req) {
  String json=getSnapshot(); httpd_resp_set_type(req,"application/json"); httpd_resp_set_hdr(req,"Cache-Control","no-store");
  return httpd_resp_send(req,json.c_str(),json.length());
}
esp_err_t wsHandler(httpd_req_t* req) {
  if(req->method==HTTP_GET) return ESP_OK;
  httpd_ws_frame_t frame={};
  esp_err_t result=httpd_ws_recv_frame(req,&frame,0);
  if(result!=ESP_OK || frame.len>128) return ESP_FAIL;
  uint8_t payload[129]={}; frame.payload=payload;
  return httpd_ws_recv_frame(req,&frame,frame.len);
}
const char* jsonString(cJSON* root,const char* key) {
  cJSON* value=cJSON_GetObjectItemCaseSensitive(root,key); return cJSON_IsString(value) ? value->valuestring : "";
}
bool printable(const char* value,size_t maxLength) {
  if(strlen(value)>maxLength) return false;
  for(size_t i=0;value[i];++i) if(uint8_t(value[i])<32 || uint8_t(value[i])>126) return false;
  return true;
}
esp_err_t commandHandler(httpd_req_t* req) {
  if(req->content_len==0 || req->content_len>768) { httpd_resp_send_err(req,HTTPD_400_BAD_REQUEST,"Command too large"); return ESP_OK; }
  char body[769]={}; size_t got=0;
  while(got<req->content_len) {
    int n=httpd_req_recv(req,body+got,req->content_len-got);
    if(n<=0) { httpd_resp_send_err(req,HTTPD_408_REQ_TIMEOUT,"Incomplete command"); return ESP_FAIL; }
    got+=n;
  }
  cJSON* root=cJSON_Parse(body);
  if(!cJSON_IsObject(root)) { cJSON_Delete(root); httpd_resp_send_err(req,HTTPD_400_BAD_REQUEST,"Invalid JSON"); return ESP_OK; }
  Command c={}; const char* op=jsonString(root,"op");
  strlcpy(c.op,op,sizeof(c.op)); strlcpy(c.id,jsonString(root,"id"),sizeof(c.id));
  bool valid=printable(op,sizeof(c.op)-1) && printable(jsonString(root,"id"),sizeof(c.id)-1);
  if(!strcmp(op,"reply")) {
    const char* text=jsonString(root,"text"), *vib=jsonString(root,"vib");
    valid &= strlen(text)>0 && strlen(text)<=160 && c.id[0];
    valid &= !strcmp(vib,"ACK") || !strcmp(vib,"YES") || !strcmp(vib,"NO") || !strcmp(vib,"MSG") || !strcmp(vib,"URGENT");
    const char* a=jsonString(root,"line1"), *b=jsonString(root,"line2");
    valid &= printable(a,16) && printable(b,16);
    strlcpy(c.text,text,sizeof(c.text)); strlcpy(c.vib,vib,sizeof(c.vib)); strlcpy(c.lines[0],a,17); strlcpy(c.lines[1],b,17);
  } else if(!strcmp(op,"bend")) {
    cJSON* reset=cJSON_GetObjectItemCaseSensitive(root,"reset"), *values=cJSON_GetObjectItemCaseSensitive(root,"values");
    c.reset=cJSON_IsTrue(reset);
    if(!c.reset) {
      valid &= cJSON_IsArray(values) && cJSON_GetArraySize(values)==5;
      for(int i=0;valid && i<5;++i) {
        cJSON* v=cJSON_GetArrayItem(values,i);
        valid &= cJSON_IsNumber(v) && v->valuedouble==v->valueint && v->valueint>=BEND_MIN && v->valueint<=BEND_MAX;
        if(valid) c.bend[i]=v->valueint;
      }
    }
  } else if(!strcmp(op,"env")) {
    const char* id=jsonString(root,"value"); c.index=-1;
    for(int e=0;e<ENV_N;++e) if(!strcmp(id,envIds[e])) c.index=e;
    valid &= c.index>=0;
  } else if(!strcmp(op,"live") || !strcmp(op,"debug")) {
    cJSON* value=cJSON_GetObjectItemCaseSensitive(root,"value"); valid &= cJSON_IsBool(value); c.value=cJSON_IsTrue(value);
  } else if(!strcmp(op,"settings")) {
    cJSON* flex=cJSON_GetObjectItemCaseSensitive(root,"useFlex"), *motor=cJSON_GetObjectItemCaseSensitive(root,"useMotor");
    valid &= cJSON_IsBool(flex) && cJSON_IsBool(motor);
    c.flex=cJSON_IsTrue(flex); c.motor=cJSON_IsTrue(motor);
  } else if(strcmp(op,"calibrate") && strcmp(op,"cancel") && strcmp(op,"status")) valid=false;
  cJSON_Delete(root);
  if(!valid) { httpd_resp_send_err(req,HTTPD_400_BAD_REQUEST,"Invalid command or fields"); return ESP_OK; }
  if(xQueueSend(commandQueue,&c,0)!=pdTRUE) {
    httpd_resp_set_status(req,"503 Service Unavailable");
    httpd_resp_sendstr(req,"Device busy; try again"); return ESP_OK;
  }
  httpd_resp_set_status(req,"202 Accepted"); httpd_resp_set_type(req,"application/json");
  return httpd_resp_sendstr(req,"{\"queued\":true}");
}
void startServer() {
  httpd_config_t config=HTTPD_DEFAULT_CONFIG(); config.stack_size=8192; config.max_open_sockets=7;
  config.lru_purge_enable=true; config.recv_wait_timeout=2; config.send_wait_timeout=1;
  if(httpd_start(&server,&config)!=ESP_OK) { server=nullptr; setNotice("Web server failed to start. Restart the glove."); return; }
  httpd_uri_t route={}; route.uri="/"; route.method=HTTP_GET; route.handler=homeHandler; httpd_register_uri_handler(server,&route);
  route.uri="/api/state"; route.handler=stateHandler; httpd_register_uri_handler(server,&route);
  route.uri="/api/command"; route.method=HTTP_POST; route.handler=commandHandler; httpd_register_uri_handler(server,&route);
  route.uri="/ws"; route.method=HTTP_GET; route.handler=wsHandler; route.is_websocket=true; httpd_register_uri_handler(server,&route);
}
void setupApp() {
  Serial.begin(115200); pinMode(MOTOR_PIN,OUTPUT); digitalWrite(MOTOR_PIN,LOW);
  analogReadResolution(12); analogSetAttenuation(ADC_11db);
  Wire.begin(21,22); Wire.setClock(400000); Wire.setTimeOut(20);
  lcdWire.begin(18,19); lcdWire.setClock(100000); lcdWire.setTimeOut(20);
  mpuOK=initMPU(); lcdOK=initLCD();
  prefs.begin("signbridge",false); loadSettings();
  snprintf(bootId,sizeof(bootId),"%08lx",(unsigned long)esp_random());
  commandQueue=xQueueCreate(8,sizeof(Command)); snapshotMutex=xSemaphoreCreateMutex();
  if(!commandQueue || !snapshotMutex) { Serial.println("Insufficient memory to start"); while(true) delay(1000); }
  WiFi.mode(WIFI_SSID[0] ? WIFI_AP_STA : WIFI_AP); WiFi.setSleep(false);
  WiFi.softAPConfig(IPAddress(192,168,4,1),IPAddress(192,168,4,1),IPAddress(255,255,255,0));
  if(!WiFi.softAP(AP_SSID,AP_PASSWORD,1,false,4)) setNotice("Could not start Wi-Fi access point.");
  if(WIFI_SSID[0]) WiFi.begin(WIFI_SSID,WIFI_PASSWORD);
  Serial.println("SIGNBRIDGE: 8 GESTURES + ENVIRONMENTS + WIFI"); printStatus();
  startCalibration(); publishState(); startServer();
}
void loopApp() {
  serialInput(); Command c={};
  if(xQueueReceive(commandQueue,&c,0)==pdTRUE) execute(c);
  tickVibration(); uint32_t now=millis();
  if(now-lastSample>=SAMPLE_MS) {
    lastSample=now;
    bool flexSampled = now-lastFlexSample>=FLEX_SAMPLE_MS;
    if(flexSampled) { lastFlexSample=now; readFlex(); }
    if(mpuOK && !readMPU()) { mpuOK=false; imuReady=false; }
    if(mpuOK) {
      memcpy(preA[preIndex],acc,sizeof(acc)); memcpy(preG[preIndex],gyr,sizeof(gyr));
      preIndex=(preIndex+1)%PRE; preCount=min(preCount+1,PRE);
    }
    tickJob(flexSampled); tickRecognition();
  }
  if(now-lastRetry>=5000) {
    lastRetry=now;
    if(!mpuOK) mpuOK=initMPU();
    if(!lcdOK || lcdError) lcdOK=initLCD();
  }
  if(now-lastLCD>=350) { lastLCD=now; updateLCD(); }
  if(liveOutput && now-lastSerial>=700) { lastSerial=now; printReadings(); }
  if(now-lastPublish>=400) {
    lastPublish=now; publishState();
    if(server && !broadcastPending.exchange(true)) if(httpd_queue_work(server,broadcast,nullptr)!=ESP_OK) broadcastPending.store(false);
  }
  delay(1);
}
} // namespace sb
void setup() { sb::setupApp(); }
void loop() { sb::loopApp(); }
